    IF :LNOT::DEF:INCLUDED_CYFITTERRV_INC
INCLUDED_CYFITTERRV_INC EQU 1
    GET cydevicerv_trm.inc

; Rx_1
Rx_1__0__DR EQU CYREG_GPIO_PRT2_DR
Rx_1__0__DR_CLR EQU CYREG_GPIO_PRT2_DR_CLR
Rx_1__0__DR_INV EQU CYREG_GPIO_PRT2_DR_INV
Rx_1__0__DR_SET EQU CYREG_GPIO_PRT2_DR_SET
Rx_1__0__HSIOM EQU CYREG_HSIOM_PORT_SEL2
Rx_1__0__HSIOM_MASK EQU 0x0F000000
Rx_1__0__HSIOM_SHIFT EQU 24
Rx_1__0__INTCFG EQU CYREG_GPIO_PRT2_INTR_CFG
Rx_1__0__INTR EQU CYREG_GPIO_PRT2_INTR
Rx_1__0__INTR_CFG EQU CYREG_GPIO_PRT2_INTR_CFG
Rx_1__0__INTSTAT EQU CYREG_GPIO_PRT2_INTR
Rx_1__0__MASK EQU 0x40
Rx_1__0__PA__CFG0 EQU CYREG_UDB_PA2_CFG0
Rx_1__0__PA__CFG1 EQU CYREG_UDB_PA2_CFG1
Rx_1__0__PA__CFG10 EQU CYREG_UDB_PA2_CFG10
Rx_1__0__PA__CFG11 EQU CYREG_UDB_PA2_CFG11
Rx_1__0__PA__CFG12 EQU CYREG_UDB_PA2_CFG12
Rx_1__0__PA__CFG13 EQU CYREG_UDB_PA2_CFG13
Rx_1__0__PA__CFG14 EQU CYREG_UDB_PA2_CFG14
Rx_1__0__PA__CFG2 EQU CYREG_UDB_PA2_CFG2
Rx_1__0__PA__CFG3 EQU CYREG_UDB_PA2_CFG3
Rx_1__0__PA__CFG4 EQU CYREG_UDB_PA2_CFG4
Rx_1__0__PA__CFG5 EQU CYREG_UDB_PA2_CFG5
Rx_1__0__PA__CFG6 EQU CYREG_UDB_PA2_CFG6
Rx_1__0__PA__CFG7 EQU CYREG_UDB_PA2_CFG7
Rx_1__0__PA__CFG8 EQU CYREG_UDB_PA2_CFG8
Rx_1__0__PA__CFG9 EQU CYREG_UDB_PA2_CFG9
Rx_1__0__PC EQU CYREG_GPIO_PRT2_PC
Rx_1__0__PC2 EQU CYREG_GPIO_PRT2_PC2
Rx_1__0__PORT EQU 2
Rx_1__0__PS EQU CYREG_GPIO_PRT2_PS
Rx_1__0__SHIFT EQU 6
Rx_1__DR EQU CYREG_GPIO_PRT2_DR
Rx_1__DR_CLR EQU CYREG_GPIO_PRT2_DR_CLR
Rx_1__DR_INV EQU CYREG_GPIO_PRT2_DR_INV
Rx_1__DR_SET EQU CYREG_GPIO_PRT2_DR_SET
Rx_1__INTCFG EQU CYREG_GPIO_PRT2_INTR_CFG
Rx_1__INTR EQU CYREG_GPIO_PRT2_INTR
Rx_1__INTR_CFG EQU CYREG_GPIO_PRT2_INTR_CFG
Rx_1__INTSTAT EQU CYREG_GPIO_PRT2_INTR
Rx_1__MASK EQU 0x40
Rx_1__PA__CFG0 EQU CYREG_UDB_PA2_CFG0
Rx_1__PA__CFG1 EQU CYREG_UDB_PA2_CFG1
Rx_1__PA__CFG10 EQU CYREG_UDB_PA2_CFG10
Rx_1__PA__CFG11 EQU CYREG_UDB_PA2_CFG11
Rx_1__PA__CFG12 EQU CYREG_UDB_PA2_CFG12
Rx_1__PA__CFG13 EQU CYREG_UDB_PA2_CFG13
Rx_1__PA__CFG14 EQU CYREG_UDB_PA2_CFG14
Rx_1__PA__CFG2 EQU CYREG_UDB_PA2_CFG2
Rx_1__PA__CFG3 EQU CYREG_UDB_PA2_CFG3
Rx_1__PA__CFG4 EQU CYREG_UDB_PA2_CFG4
Rx_1__PA__CFG5 EQU CYREG_UDB_PA2_CFG5
Rx_1__PA__CFG6 EQU CYREG_UDB_PA2_CFG6
Rx_1__PA__CFG7 EQU CYREG_UDB_PA2_CFG7
Rx_1__PA__CFG8 EQU CYREG_UDB_PA2_CFG8
Rx_1__PA__CFG9 EQU CYREG_UDB_PA2_CFG9
Rx_1__PC EQU CYREG_GPIO_PRT2_PC
Rx_1__PC2 EQU CYREG_GPIO_PRT2_PC2
Rx_1__PORT EQU 2
Rx_1__PS EQU CYREG_GPIO_PRT2_PS
Rx_1__SHIFT EQU 6

; Tx_1
Tx_1__0__DR EQU CYREG_GPIO_PRT2_DR
Tx_1__0__DR_CLR EQU CYREG_GPIO_PRT2_DR_CLR
Tx_1__0__DR_INV EQU CYREG_GPIO_PRT2_DR_INV
Tx_1__0__DR_SET EQU CYREG_GPIO_PRT2_DR_SET
Tx_1__0__HSIOM EQU CYREG_HSIOM_PORT_SEL2
Tx_1__0__HSIOM_MASK EQU 0xF0000000
Tx_1__0__HSIOM_SHIFT EQU 28
Tx_1__0__INTCFG EQU CYREG_GPIO_PRT2_INTR_CFG
Tx_1__0__INTR EQU CYREG_GPIO_PRT2_INTR
Tx_1__0__INTR_CFG EQU CYREG_GPIO_PRT2_INTR_CFG
Tx_1__0__INTSTAT EQU CYREG_GPIO_PRT2_INTR
Tx_1__0__MASK EQU 0x80
Tx_1__0__OUT_SEL EQU CYREG_UDB_PA2_CFG10
Tx_1__0__OUT_SEL_SHIFT EQU 14
Tx_1__0__OUT_SEL_VAL EQU 2
Tx_1__0__PA__CFG0 EQU CYREG_UDB_PA2_CFG0
Tx_1__0__PA__CFG1 EQU CYREG_UDB_PA2_CFG1
Tx_1__0__PA__CFG10 EQU CYREG_UDB_PA2_CFG10
Tx_1__0__PA__CFG11 EQU CYREG_UDB_PA2_CFG11
Tx_1__0__PA__CFG12 EQU CYREG_UDB_PA2_CFG12
Tx_1__0__PA__CFG13 EQU CYREG_UDB_PA2_CFG13
Tx_1__0__PA__CFG14 EQU CYREG_UDB_PA2_CFG14
Tx_1__0__PA__CFG2 EQU CYREG_UDB_PA2_CFG2
Tx_1__0__PA__CFG3 EQU CYREG_UDB_PA2_CFG3
Tx_1__0__PA__CFG4 EQU CYREG_UDB_PA2_CFG4
Tx_1__0__PA__CFG5 EQU CYREG_UDB_PA2_CFG5
Tx_1__0__PA__CFG6 EQU CYREG_UDB_PA2_CFG6
Tx_1__0__PA__CFG7 EQU CYREG_UDB_PA2_CFG7
Tx_1__0__PA__CFG8 EQU CYREG_UDB_PA2_CFG8
Tx_1__0__PA__CFG9 EQU CYREG_UDB_PA2_CFG9
Tx_1__0__PC EQU CYREG_GPIO_PRT2_PC
Tx_1__0__PC2 EQU CYREG_GPIO_PRT2_PC2
Tx_1__0__PORT EQU 2
Tx_1__0__PS EQU CYREG_GPIO_PRT2_PS
Tx_1__0__SHIFT EQU 7
Tx_1__DR EQU CYREG_GPIO_PRT2_DR
Tx_1__DR_CLR EQU CYREG_GPIO_PRT2_DR_CLR
Tx_1__DR_INV EQU CYREG_GPIO_PRT2_DR_INV
Tx_1__DR_SET EQU CYREG_GPIO_PRT2_DR_SET
Tx_1__INTCFG EQU CYREG_GPIO_PRT2_INTR_CFG
Tx_1__INTR EQU CYREG_GPIO_PRT2_INTR
Tx_1__INTR_CFG EQU CYREG_GPIO_PRT2_INTR_CFG
Tx_1__INTSTAT EQU CYREG_GPIO_PRT2_INTR
Tx_1__MASK EQU 0x80
Tx_1__PA__CFG0 EQU CYREG_UDB_PA2_CFG0
Tx_1__PA__CFG1 EQU CYREG_UDB_PA2_CFG1
Tx_1__PA__CFG10 EQU CYREG_UDB_PA2_CFG10
Tx_1__PA__CFG11 EQU CYREG_UDB_PA2_CFG11
Tx_1__PA__CFG12 EQU CYREG_UDB_PA2_CFG12
Tx_1__PA__CFG13 EQU CYREG_UDB_PA2_CFG13
Tx_1__PA__CFG14 EQU CYREG_UDB_PA2_CFG14
Tx_1__PA__CFG2 EQU CYREG_UDB_PA2_CFG2
Tx_1__PA__CFG3 EQU CYREG_UDB_PA2_CFG3
Tx_1__PA__CFG4 EQU CYREG_UDB_PA2_CFG4
Tx_1__PA__CFG5 EQU CYREG_UDB_PA2_CFG5
Tx_1__PA__CFG6 EQU CYREG_UDB_PA2_CFG6
Tx_1__PA__CFG7 EQU CYREG_UDB_PA2_CFG7
Tx_1__PA__CFG8 EQU CYREG_UDB_PA2_CFG8
Tx_1__PA__CFG9 EQU CYREG_UDB_PA2_CFG9
Tx_1__PC EQU CYREG_GPIO_PRT2_PC
Tx_1__PC2 EQU CYREG_GPIO_PRT2_PC2
Tx_1__PORT EQU 2
Tx_1__PS EQU CYREG_GPIO_PRT2_PS
Tx_1__SHIFT EQU 7

; LED_1
LED_1__0__DR EQU CYREG_GPIO_PRT2_DR
LED_1__0__DR_CLR EQU CYREG_GPIO_PRT2_DR_CLR
LED_1__0__DR_INV EQU CYREG_GPIO_PRT2_DR_INV
LED_1__0__DR_SET EQU CYREG_GPIO_PRT2_DR_SET
LED_1__0__HSIOM EQU CYREG_HSIOM_PORT_SEL2
LED_1__0__HSIOM_MASK EQU 0x00000F00
LED_1__0__HSIOM_SHIFT EQU 8
LED_1__0__INTCFG EQU CYREG_GPIO_PRT2_INTR_CFG
LED_1__0__INTR EQU CYREG_GPIO_PRT2_INTR
LED_1__0__INTR_CFG EQU CYREG_GPIO_PRT2_INTR_CFG
LED_1__0__INTSTAT EQU CYREG_GPIO_PRT2_INTR
LED_1__0__MASK EQU 0x04
LED_1__0__PA__CFG0 EQU CYREG_UDB_PA2_CFG0
LED_1__0__PA__CFG1 EQU CYREG_UDB_PA2_CFG1
LED_1__0__PA__CFG10 EQU CYREG_UDB_PA2_CFG10
LED_1__0__PA__CFG11 EQU CYREG_UDB_PA2_CFG11
LED_1__0__PA__CFG12 EQU CYREG_UDB_PA2_CFG12
LED_1__0__PA__CFG13 EQU CYREG_UDB_PA2_CFG13
LED_1__0__PA__CFG14 EQU CYREG_UDB_PA2_CFG14
LED_1__0__PA__CFG2 EQU CYREG_UDB_PA2_CFG2
LED_1__0__PA__CFG3 EQU CYREG_UDB_PA2_CFG3
LED_1__0__PA__CFG4 EQU CYREG_UDB_PA2_CFG4
LED_1__0__PA__CFG5 EQU CYREG_UDB_PA2_CFG5
LED_1__0__PA__CFG6 EQU CYREG_UDB_PA2_CFG6
LED_1__0__PA__CFG7 EQU CYREG_UDB_PA2_CFG7
LED_1__0__PA__CFG8 EQU CYREG_UDB_PA2_CFG8
LED_1__0__PA__CFG9 EQU CYREG_UDB_PA2_CFG9
LED_1__0__PC EQU CYREG_GPIO_PRT2_PC
LED_1__0__PC2 EQU CYREG_GPIO_PRT2_PC2
LED_1__0__PORT EQU 2
LED_1__0__PS EQU CYREG_GPIO_PRT2_PS
LED_1__0__SHIFT EQU 2
LED_1__DR EQU CYREG_GPIO_PRT2_DR
LED_1__DR_CLR EQU CYREG_GPIO_PRT2_DR_CLR
LED_1__DR_INV EQU CYREG_GPIO_PRT2_DR_INV
LED_1__DR_SET EQU CYREG_GPIO_PRT2_DR_SET
LED_1__INTCFG EQU CYREG_GPIO_PRT2_INTR_CFG
LED_1__INTR EQU CYREG_GPIO_PRT2_INTR
LED_1__INTR_CFG EQU CYREG_GPIO_PRT2_INTR_CFG
LED_1__INTSTAT EQU CYREG_GPIO_PRT2_INTR
LED_1__MASK EQU 0x04
LED_1__PA__CFG0 EQU CYREG_UDB_PA2_CFG0
LED_1__PA__CFG1 EQU CYREG_UDB_PA2_CFG1
LED_1__PA__CFG10 EQU CYREG_UDB_PA2_CFG10
LED_1__PA__CFG11 EQU CYREG_UDB_PA2_CFG11
LED_1__PA__CFG12 EQU CYREG_UDB_PA2_CFG12
LED_1__PA__CFG13 EQU CYREG_UDB_PA2_CFG13
LED_1__PA__CFG14 EQU CYREG_UDB_PA2_CFG14
LED_1__PA__CFG2 EQU CYREG_UDB_PA2_CFG2
LED_1__PA__CFG3 EQU CYREG_UDB_PA2_CFG3
LED_1__PA__CFG4 EQU CYREG_UDB_PA2_CFG4
LED_1__PA__CFG5 EQU CYREG_UDB_PA2_CFG5
LED_1__PA__CFG6 EQU CYREG_UDB_PA2_CFG6
LED_1__PA__CFG7 EQU CYREG_UDB_PA2_CFG7
LED_1__PA__CFG8 EQU CYREG_UDB_PA2_CFG8
LED_1__PA__CFG9 EQU CYREG_UDB_PA2_CFG9
LED_1__PC EQU CYREG_GPIO_PRT2_PC
LED_1__PC2 EQU CYREG_GPIO_PRT2_PC2
LED_1__PORT EQU 2
LED_1__PS EQU CYREG_GPIO_PRT2_PS
LED_1__SHIFT EQU 2

; LED_2
LED_2__0__DR EQU CYREG_GPIO_PRT2_DR
LED_2__0__DR_CLR EQU CYREG_GPIO_PRT2_DR_CLR
LED_2__0__DR_INV EQU CYREG_GPIO_PRT2_DR_INV
LED_2__0__DR_SET EQU CYREG_GPIO_PRT2_DR_SET
LED_2__0__HSIOM EQU CYREG_HSIOM_PORT_SEL2
LED_2__0__HSIOM_MASK EQU 0x0000F000
LED_2__0__HSIOM_SHIFT EQU 12
LED_2__0__INTCFG EQU CYREG_GPIO_PRT2_INTR_CFG
LED_2__0__INTR EQU CYREG_GPIO_PRT2_INTR
LED_2__0__INTR_CFG EQU CYREG_GPIO_PRT2_INTR_CFG
LED_2__0__INTSTAT EQU CYREG_GPIO_PRT2_INTR
LED_2__0__MASK EQU 0x08
LED_2__0__PA__CFG0 EQU CYREG_UDB_PA2_CFG0
LED_2__0__PA__CFG1 EQU CYREG_UDB_PA2_CFG1
LED_2__0__PA__CFG10 EQU CYREG_UDB_PA2_CFG10
LED_2__0__PA__CFG11 EQU CYREG_UDB_PA2_CFG11
LED_2__0__PA__CFG12 EQU CYREG_UDB_PA2_CFG12
LED_2__0__PA__CFG13 EQU CYREG_UDB_PA2_CFG13
LED_2__0__PA__CFG14 EQU CYREG_UDB_PA2_CFG14
LED_2__0__PA__CFG2 EQU CYREG_UDB_PA2_CFG2
LED_2__0__PA__CFG3 EQU CYREG_UDB_PA2_CFG3
LED_2__0__PA__CFG4 EQU CYREG_UDB_PA2_CFG4
LED_2__0__PA__CFG5 EQU CYREG_UDB_PA2_CFG5
LED_2__0__PA__CFG6 EQU CYREG_UDB_PA2_CFG6
LED_2__0__PA__CFG7 EQU CYREG_UDB_PA2_CFG7
LED_2__0__PA__CFG8 EQU CYREG_UDB_PA2_CFG8
LED_2__0__PA__CFG9 EQU CYREG_UDB_PA2_CFG9
LED_2__0__PC EQU CYREG_GPIO_PRT2_PC
LED_2__0__PC2 EQU CYREG_GPIO_PRT2_PC2
LED_2__0__PORT EQU 2
LED_2__0__PS EQU CYREG_GPIO_PRT2_PS
LED_2__0__SHIFT EQU 3
LED_2__DR EQU CYREG_GPIO_PRT2_DR
LED_2__DR_CLR EQU CYREG_GPIO_PRT2_DR_CLR
LED_2__DR_INV EQU CYREG_GPIO_PRT2_DR_INV
LED_2__DR_SET EQU CYREG_GPIO_PRT2_DR_SET
LED_2__INTCFG EQU CYREG_GPIO_PRT2_INTR_CFG
LED_2__INTR EQU CYREG_GPIO_PRT2_INTR
LED_2__INTR_CFG EQU CYREG_GPIO_PRT2_INTR_CFG
LED_2__INTSTAT EQU CYREG_GPIO_PRT2_INTR
LED_2__MASK EQU 0x08
LED_2__PA__CFG0 EQU CYREG_UDB_PA2_CFG0
LED_2__PA__CFG1 EQU CYREG_UDB_PA2_CFG1
LED_2__PA__CFG10 EQU CYREG_UDB_PA2_CFG10
LED_2__PA__CFG11 EQU CYREG_UDB_PA2_CFG11
LED_2__PA__CFG12 EQU CYREG_UDB_PA2_CFG12
LED_2__PA__CFG13 EQU CYREG_UDB_PA2_CFG13
LED_2__PA__CFG14 EQU CYREG_UDB_PA2_CFG14
LED_2__PA__CFG2 EQU CYREG_UDB_PA2_CFG2
LED_2__PA__CFG3 EQU CYREG_UDB_PA2_CFG3
LED_2__PA__CFG4 EQU CYREG_UDB_PA2_CFG4
LED_2__PA__CFG5 EQU CYREG_UDB_PA2_CFG5
LED_2__PA__CFG6 EQU CYREG_UDB_PA2_CFG6
LED_2__PA__CFG7 EQU CYREG_UDB_PA2_CFG7
LED_2__PA__CFG8 EQU CYREG_UDB_PA2_CFG8
LED_2__PA__CFG9 EQU CYREG_UDB_PA2_CFG9
LED_2__PC EQU CYREG_GPIO_PRT2_PC
LED_2__PC2 EQU CYREG_GPIO_PRT2_PC2
LED_2__PORT EQU 2
LED_2__PS EQU CYREG_GPIO_PRT2_PS
LED_2__SHIFT EQU 3

; LED_3
LED_3__0__DR EQU CYREG_GPIO_PRT2_DR
LED_3__0__DR_CLR EQU CYREG_GPIO_PRT2_DR_CLR
LED_3__0__DR_INV EQU CYREG_GPIO_PRT2_DR_INV
LED_3__0__DR_SET EQU CYREG_GPIO_PRT2_DR_SET
LED_3__0__HSIOM EQU CYREG_HSIOM_PORT_SEL2
LED_3__0__HSIOM_MASK EQU 0x000F0000
LED_3__0__HSIOM_SHIFT EQU 16
LED_3__0__INTCFG EQU CYREG_GPIO_PRT2_INTR_CFG
LED_3__0__INTR EQU CYREG_GPIO_PRT2_INTR
LED_3__0__INTR_CFG EQU CYREG_GPIO_PRT2_INTR_CFG
LED_3__0__INTSTAT EQU CYREG_GPIO_PRT2_INTR
LED_3__0__MASK EQU 0x10
LED_3__0__PA__CFG0 EQU CYREG_UDB_PA2_CFG0
LED_3__0__PA__CFG1 EQU CYREG_UDB_PA2_CFG1
LED_3__0__PA__CFG10 EQU CYREG_UDB_PA2_CFG10
LED_3__0__PA__CFG11 EQU CYREG_UDB_PA2_CFG11
LED_3__0__PA__CFG12 EQU CYREG_UDB_PA2_CFG12
LED_3__0__PA__CFG13 EQU CYREG_UDB_PA2_CFG13
LED_3__0__PA__CFG14 EQU CYREG_UDB_PA2_CFG14
LED_3__0__PA__CFG2 EQU CYREG_UDB_PA2_CFG2
LED_3__0__PA__CFG3 EQU CYREG_UDB_PA2_CFG3
LED_3__0__PA__CFG4 EQU CYREG_UDB_PA2_CFG4
LED_3__0__PA__CFG5 EQU CYREG_UDB_PA2_CFG5
LED_3__0__PA__CFG6 EQU CYREG_UDB_PA2_CFG6
LED_3__0__PA__CFG7 EQU CYREG_UDB_PA2_CFG7
LED_3__0__PA__CFG8 EQU CYREG_UDB_PA2_CFG8
LED_3__0__PA__CFG9 EQU CYREG_UDB_PA2_CFG9
LED_3__0__PC EQU CYREG_GPIO_PRT2_PC
LED_3__0__PC2 EQU CYREG_GPIO_PRT2_PC2
LED_3__0__PORT EQU 2
LED_3__0__PS EQU CYREG_GPIO_PRT2_PS
LED_3__0__SHIFT EQU 4
LED_3__DR EQU CYREG_GPIO_PRT2_DR
LED_3__DR_CLR EQU CYREG_GPIO_PRT2_DR_CLR
LED_3__DR_INV EQU CYREG_GPIO_PRT2_DR_INV
LED_3__DR_SET EQU CYREG_GPIO_PRT2_DR_SET
LED_3__INTCFG EQU CYREG_GPIO_PRT2_INTR_CFG
LED_3__INTR EQU CYREG_GPIO_PRT2_INTR
LED_3__INTR_CFG EQU CYREG_GPIO_PRT2_INTR_CFG
LED_3__INTSTAT EQU CYREG_GPIO_PRT2_INTR
LED_3__MASK EQU 0x10
LED_3__PA__CFG0 EQU CYREG_UDB_PA2_CFG0
LED_3__PA__CFG1 EQU CYREG_UDB_PA2_CFG1
LED_3__PA__CFG10 EQU CYREG_UDB_PA2_CFG10
LED_3__PA__CFG11 EQU CYREG_UDB_PA2_CFG11
LED_3__PA__CFG12 EQU CYREG_UDB_PA2_CFG12
LED_3__PA__CFG13 EQU CYREG_UDB_PA2_CFG13
LED_3__PA__CFG14 EQU CYREG_UDB_PA2_CFG14
LED_3__PA__CFG2 EQU CYREG_UDB_PA2_CFG2
LED_3__PA__CFG3 EQU CYREG_UDB_PA2_CFG3
LED_3__PA__CFG4 EQU CYREG_UDB_PA2_CFG4
LED_3__PA__CFG5 EQU CYREG_UDB_PA2_CFG5
LED_3__PA__CFG6 EQU CYREG_UDB_PA2_CFG6
LED_3__PA__CFG7 EQU CYREG_UDB_PA2_CFG7
LED_3__PA__CFG8 EQU CYREG_UDB_PA2_CFG8
LED_3__PA__CFG9 EQU CYREG_UDB_PA2_CFG9
LED_3__PC EQU CYREG_GPIO_PRT2_PC
LED_3__PC2 EQU CYREG_GPIO_PRT2_PC2
LED_3__PORT EQU 2
LED_3__PS EQU CYREG_GPIO_PRT2_PS
LED_3__SHIFT EQU 4

; LED_4
LED_4__0__DR EQU CYREG_GPIO_PRT2_DR
LED_4__0__DR_CLR EQU CYREG_GPIO_PRT2_DR_CLR
LED_4__0__DR_INV EQU CYREG_GPIO_PRT2_DR_INV
LED_4__0__DR_SET EQU CYREG_GPIO_PRT2_DR_SET
LED_4__0__HSIOM EQU CYREG_HSIOM_PORT_SEL2
LED_4__0__HSIOM_MASK EQU 0x00F00000
LED_4__0__HSIOM_SHIFT EQU 20
LED_4__0__INTCFG EQU CYREG_GPIO_PRT2_INTR_CFG
LED_4__0__INTR EQU CYREG_GPIO_PRT2_INTR
LED_4__0__INTR_CFG EQU CYREG_GPIO_PRT2_INTR_CFG
LED_4__0__INTSTAT EQU CYREG_GPIO_PRT2_INTR
LED_4__0__MASK EQU 0x20
LED_4__0__PA__CFG0 EQU CYREG_UDB_PA2_CFG0
LED_4__0__PA__CFG1 EQU CYREG_UDB_PA2_CFG1
LED_4__0__PA__CFG10 EQU CYREG_UDB_PA2_CFG10
LED_4__0__PA__CFG11 EQU CYREG_UDB_PA2_CFG11
LED_4__0__PA__CFG12 EQU CYREG_UDB_PA2_CFG12
LED_4__0__PA__CFG13 EQU CYREG_UDB_PA2_CFG13
LED_4__0__PA__CFG14 EQU CYREG_UDB_PA2_CFG14
LED_4__0__PA__CFG2 EQU CYREG_UDB_PA2_CFG2
LED_4__0__PA__CFG3 EQU CYREG_UDB_PA2_CFG3
LED_4__0__PA__CFG4 EQU CYREG_UDB_PA2_CFG4
LED_4__0__PA__CFG5 EQU CYREG_UDB_PA2_CFG5
LED_4__0__PA__CFG6 EQU CYREG_UDB_PA2_CFG6
LED_4__0__PA__CFG7 EQU CYREG_UDB_PA2_CFG7
LED_4__0__PA__CFG8 EQU CYREG_UDB_PA2_CFG8
LED_4__0__PA__CFG9 EQU CYREG_UDB_PA2_CFG9
LED_4__0__PC EQU CYREG_GPIO_PRT2_PC
LED_4__0__PC2 EQU CYREG_GPIO_PRT2_PC2
LED_4__0__PORT EQU 2
LED_4__0__PS EQU CYREG_GPIO_PRT2_PS
LED_4__0__SHIFT EQU 5
LED_4__DR EQU CYREG_GPIO_PRT2_DR
LED_4__DR_CLR EQU CYREG_GPIO_PRT2_DR_CLR
LED_4__DR_INV EQU CYREG_GPIO_PRT2_DR_INV
LED_4__DR_SET EQU CYREG_GPIO_PRT2_DR_SET
LED_4__INTCFG EQU CYREG_GPIO_PRT2_INTR_CFG
LED_4__INTR EQU CYREG_GPIO_PRT2_INTR
LED_4__INTR_CFG EQU CYREG_GPIO_PRT2_INTR_CFG
LED_4__INTSTAT EQU CYREG_GPIO_PRT2_INTR
LED_4__MASK EQU 0x20
LED_4__PA__CFG0 EQU CYREG_UDB_PA2_CFG0
LED_4__PA__CFG1 EQU CYREG_UDB_PA2_CFG1
LED_4__PA__CFG10 EQU CYREG_UDB_PA2_CFG10
LED_4__PA__CFG11 EQU CYREG_UDB_PA2_CFG11
LED_4__PA__CFG12 EQU CYREG_UDB_PA2_CFG12
LED_4__PA__CFG13 EQU CYREG_UDB_PA2_CFG13
LED_4__PA__CFG14 EQU CYREG_UDB_PA2_CFG14
LED_4__PA__CFG2 EQU CYREG_UDB_PA2_CFG2
LED_4__PA__CFG3 EQU CYREG_UDB_PA2_CFG3
LED_4__PA__CFG4 EQU CYREG_UDB_PA2_CFG4
LED_4__PA__CFG5 EQU CYREG_UDB_PA2_CFG5
LED_4__PA__CFG6 EQU CYREG_UDB_PA2_CFG6
LED_4__PA__CFG7 EQU CYREG_UDB_PA2_CFG7
LED_4__PA__CFG8 EQU CYREG_UDB_PA2_CFG8
LED_4__PA__CFG9 EQU CYREG_UDB_PA2_CFG9
LED_4__PC EQU CYREG_GPIO_PRT2_PC
LED_4__PC2 EQU CYREG_GPIO_PRT2_PC2
LED_4__PORT EQU 2
LED_4__PS EQU CYREG_GPIO_PRT2_PS
LED_4__SHIFT EQU 5

; MOTOR_BUART
MOTOR_BUART_sRX_RxBitCounter__16BIT_CONTROL_AUX_CTL_REG EQU CYREG_UDB_W16_ACTL1
MOTOR_BUART_sRX_RxBitCounter__16BIT_CONTROL_CONTROL_REG EQU CYREG_UDB_W16_CTL1
MOTOR_BUART_sRX_RxBitCounter__16BIT_CONTROL_COUNT_REG EQU CYREG_UDB_W16_CTL1
MOTOR_BUART_sRX_RxBitCounter__16BIT_COUNT_CONTROL_REG EQU CYREG_UDB_W16_CTL1
MOTOR_BUART_sRX_RxBitCounter__16BIT_COUNT_COUNT_REG EQU CYREG_UDB_W16_CTL1
MOTOR_BUART_sRX_RxBitCounter__16BIT_MASK_MASK_REG EQU CYREG_UDB_W16_MSK1
MOTOR_BUART_sRX_RxBitCounter__16BIT_MASK_PERIOD_REG EQU CYREG_UDB_W16_MSK1
MOTOR_BUART_sRX_RxBitCounter__16BIT_PERIOD_MASK_REG EQU CYREG_UDB_W16_MSK1
MOTOR_BUART_sRX_RxBitCounter__16BIT_PERIOD_PERIOD_REG EQU CYREG_UDB_W16_MSK1
MOTOR_BUART_sRX_RxBitCounter__CONTROL_AUX_CTL_REG EQU CYREG_UDB_W8_ACTL1
MOTOR_BUART_sRX_RxBitCounter__CONTROL_REG EQU CYREG_UDB_W8_CTL1
MOTOR_BUART_sRX_RxBitCounter__CONTROL_ST_REG EQU CYREG_UDB_CAT16_CTL_ST1
MOTOR_BUART_sRX_RxBitCounter__COUNT_REG EQU CYREG_UDB_W8_CTL1
MOTOR_BUART_sRX_RxBitCounter__COUNT_ST_REG EQU CYREG_UDB_CAT16_CTL_ST1
MOTOR_BUART_sRX_RxBitCounter__MASK_CTL_AUX_CTL_REG EQU CYREG_UDB_CAT16_ACTL_MSK1
MOTOR_BUART_sRX_RxBitCounter__PER_CTL_AUX_CTL_REG EQU CYREG_UDB_CAT16_ACTL_MSK1
MOTOR_BUART_sRX_RxBitCounter__PERIOD_REG EQU CYREG_UDB_W8_MSK1
MOTOR_BUART_sRX_RxBitCounter_ST__16BIT_STATUS_AUX_CTL_REG EQU CYREG_UDB_W16_ACTL1
MOTOR_BUART_sRX_RxBitCounter_ST__16BIT_STATUS_REG EQU CYREG_UDB_W16_ST1
MOTOR_BUART_sRX_RxBitCounter_ST__MASK_REG EQU CYREG_UDB_W8_MSK1
MOTOR_BUART_sRX_RxBitCounter_ST__MASK_ST_AUX_CTL_REG EQU CYREG_UDB_CAT16_ACTL_MSK1
MOTOR_BUART_sRX_RxBitCounter_ST__PER_ST_AUX_CTL_REG EQU CYREG_UDB_CAT16_ACTL_MSK1
MOTOR_BUART_sRX_RxBitCounter_ST__STATUS_AUX_CTL_REG EQU CYREG_UDB_W8_ACTL1
MOTOR_BUART_sRX_RxBitCounter_ST__STATUS_CNT_REG EQU CYREG_UDB_CAT16_CTL_ST1
MOTOR_BUART_sRX_RxBitCounter_ST__STATUS_CONTROL_REG EQU CYREG_UDB_CAT16_CTL_ST1
MOTOR_BUART_sRX_RxBitCounter_ST__STATUS_REG EQU CYREG_UDB_W8_ST1
MOTOR_BUART_sRX_RxShifter_u0__16BIT_A0_REG EQU CYREG_UDB_W16_A01
MOTOR_BUART_sRX_RxShifter_u0__16BIT_A1_REG EQU CYREG_UDB_W16_A11
MOTOR_BUART_sRX_RxShifter_u0__16BIT_D0_REG EQU CYREG_UDB_W16_D01
MOTOR_BUART_sRX_RxShifter_u0__16BIT_D1_REG EQU CYREG_UDB_W16_D11
MOTOR_BUART_sRX_RxShifter_u0__16BIT_DP_AUX_CTL_REG EQU CYREG_UDB_W16_ACTL1
MOTOR_BUART_sRX_RxShifter_u0__16BIT_F0_REG EQU CYREG_UDB_W16_F01
MOTOR_BUART_sRX_RxShifter_u0__16BIT_F1_REG EQU CYREG_UDB_W16_F11
MOTOR_BUART_sRX_RxShifter_u0__A0_A1_REG EQU CYREG_UDB_CAT16_A1
MOTOR_BUART_sRX_RxShifter_u0__A0_REG EQU CYREG_UDB_W8_A01
MOTOR_BUART_sRX_RxShifter_u0__A1_REG EQU CYREG_UDB_W8_A11
MOTOR_BUART_sRX_RxShifter_u0__D0_D1_REG EQU CYREG_UDB_CAT16_D1
MOTOR_BUART_sRX_RxShifter_u0__D0_REG EQU CYREG_UDB_W8_D01
MOTOR_BUART_sRX_RxShifter_u0__D1_REG EQU CYREG_UDB_W8_D11
MOTOR_BUART_sRX_RxShifter_u0__DP_AUX_CTL_REG EQU CYREG_UDB_W8_ACTL1
MOTOR_BUART_sRX_RxShifter_u0__F0_F1_REG EQU CYREG_UDB_CAT16_F1
MOTOR_BUART_sRX_RxShifter_u0__F0_REG EQU CYREG_UDB_W8_F01
MOTOR_BUART_sRX_RxShifter_u0__F1_REG EQU CYREG_UDB_W8_F11
MOTOR_BUART_sRX_RxShifter_u0__MSK_DP_AUX_CTL_REG EQU CYREG_UDB_CAT16_ACTL_MSK1
MOTOR_BUART_sRX_RxShifter_u0__PER_DP_AUX_CTL_REG EQU CYREG_UDB_CAT16_ACTL_MSK1
MOTOR_BUART_sRX_RxSts__16BIT_STATUS_AUX_CTL_REG EQU CYREG_UDB_W16_ACTL0
MOTOR_BUART_sRX_RxSts__16BIT_STATUS_REG EQU CYREG_UDB_W16_ST0
MOTOR_BUART_sRX_RxSts__3__MASK EQU 0x08
MOTOR_BUART_sRX_RxSts__3__POS EQU 3
MOTOR_BUART_sRX_RxSts__32BIT_MASK_REG EQU CYREG_UDB_W32_MSK
MOTOR_BUART_sRX_RxSts__32BIT_STATUS_AUX_CTL_REG EQU CYREG_UDB_W32_ACTL
MOTOR_BUART_sRX_RxSts__32BIT_STATUS_REG EQU CYREG_UDB_W32_ST
MOTOR_BUART_sRX_RxSts__4__MASK EQU 0x10
MOTOR_BUART_sRX_RxSts__4__POS EQU 4
MOTOR_BUART_sRX_RxSts__5__MASK EQU 0x20
MOTOR_BUART_sRX_RxSts__5__POS EQU 5
MOTOR_BUART_sRX_RxSts__MASK EQU 0x38
MOTOR_BUART_sRX_RxSts__MASK_REG EQU CYREG_UDB_W8_MSK0
MOTOR_BUART_sRX_RxSts__STATUS_AUX_CTL_REG EQU CYREG_UDB_W8_ACTL0
MOTOR_BUART_sRX_RxSts__STATUS_REG EQU CYREG_UDB_W8_ST0
MOTOR_BUART_sTX_sCLOCK_TxBitClkGen__A0_A1_REG EQU CYREG_UDB_CAT16_A3
MOTOR_BUART_sTX_sCLOCK_TxBitClkGen__A0_REG EQU CYREG_UDB_W8_A03
MOTOR_BUART_sTX_sCLOCK_TxBitClkGen__A1_REG EQU CYREG_UDB_W8_A13
MOTOR_BUART_sTX_sCLOCK_TxBitClkGen__D0_D1_REG EQU CYREG_UDB_CAT16_D3
MOTOR_BUART_sTX_sCLOCK_TxBitClkGen__D0_REG EQU CYREG_UDB_W8_D03
MOTOR_BUART_sTX_sCLOCK_TxBitClkGen__D1_REG EQU CYREG_UDB_W8_D13
MOTOR_BUART_sTX_sCLOCK_TxBitClkGen__DP_AUX_CTL_REG EQU CYREG_UDB_W8_ACTL3
MOTOR_BUART_sTX_sCLOCK_TxBitClkGen__F0_F1_REG EQU CYREG_UDB_CAT16_F3
MOTOR_BUART_sTX_sCLOCK_TxBitClkGen__F0_REG EQU CYREG_UDB_W8_F03
MOTOR_BUART_sTX_sCLOCK_TxBitClkGen__F1_REG EQU CYREG_UDB_W8_F13
MOTOR_BUART_sTX_TxShifter_u0__16BIT_A0_REG EQU CYREG_UDB_W16_A02
MOTOR_BUART_sTX_TxShifter_u0__16BIT_A1_REG EQU CYREG_UDB_W16_A12
MOTOR_BUART_sTX_TxShifter_u0__16BIT_D0_REG EQU CYREG_UDB_W16_D02
MOTOR_BUART_sTX_TxShifter_u0__16BIT_D1_REG EQU CYREG_UDB_W16_D12
MOTOR_BUART_sTX_TxShifter_u0__16BIT_DP_AUX_CTL_REG EQU CYREG_UDB_W16_ACTL2
MOTOR_BUART_sTX_TxShifter_u0__16BIT_F0_REG EQU CYREG_UDB_W16_F02
MOTOR_BUART_sTX_TxShifter_u0__16BIT_F1_REG EQU CYREG_UDB_W16_F12
MOTOR_BUART_sTX_TxShifter_u0__A0_A1_REG EQU CYREG_UDB_CAT16_A2
MOTOR_BUART_sTX_TxShifter_u0__A0_REG EQU CYREG_UDB_W8_A02
MOTOR_BUART_sTX_TxShifter_u0__A1_REG EQU CYREG_UDB_W8_A12
MOTOR_BUART_sTX_TxShifter_u0__D0_D1_REG EQU CYREG_UDB_CAT16_D2
MOTOR_BUART_sTX_TxShifter_u0__D0_REG EQU CYREG_UDB_W8_D02
MOTOR_BUART_sTX_TxShifter_u0__D1_REG EQU CYREG_UDB_W8_D12
MOTOR_BUART_sTX_TxShifter_u0__DP_AUX_CTL_REG EQU CYREG_UDB_W8_ACTL2
MOTOR_BUART_sTX_TxShifter_u0__F0_F1_REG EQU CYREG_UDB_CAT16_F2
MOTOR_BUART_sTX_TxShifter_u0__F0_REG EQU CYREG_UDB_W8_F02
MOTOR_BUART_sTX_TxShifter_u0__F1_REG EQU CYREG_UDB_W8_F12
MOTOR_BUART_sTX_TxSts__0__MASK EQU 0x01
MOTOR_BUART_sTX_TxSts__0__POS EQU 0
MOTOR_BUART_sTX_TxSts__1__MASK EQU 0x02
MOTOR_BUART_sTX_TxSts__1__POS EQU 1
MOTOR_BUART_sTX_TxSts__16BIT_STATUS_AUX_CTL_REG EQU CYREG_UDB_W16_ACTL2
MOTOR_BUART_sTX_TxSts__16BIT_STATUS_REG EQU CYREG_UDB_W16_ST2
MOTOR_BUART_sTX_TxSts__2__MASK EQU 0x04
MOTOR_BUART_sTX_TxSts__2__POS EQU 2
MOTOR_BUART_sTX_TxSts__3__MASK EQU 0x08
MOTOR_BUART_sTX_TxSts__3__POS EQU 3
MOTOR_BUART_sTX_TxSts__MASK EQU 0x0F
MOTOR_BUART_sTX_TxSts__MASK_REG EQU CYREG_UDB_W8_MSK2
MOTOR_BUART_sTX_TxSts__STATUS_AUX_CTL_REG EQU CYREG_UDB_W8_ACTL2
MOTOR_BUART_sTX_TxSts__STATUS_REG EQU CYREG_UDB_W8_ST2

; MOTOR_IntClock
MOTOR_IntClock__CTRL_REGISTER EQU CYREG_PERI_PCLK_CTL19
MOTOR_IntClock__DIV_ID EQU 0x00000040
MOTOR_IntClock__DIV_REGISTER EQU CYREG_PERI_DIV_16_CTL0
MOTOR_IntClock__PA_DIV_ID EQU 0x000000FF

; Miscellaneous
CYDEV_BCLK__HFCLK__HZ EQU 48000000
CYDEV_BCLK__HFCLK__KHZ EQU 48000
CYDEV_BCLK__HFCLK__MHZ EQU 48
CYDEV_BCLK__SYSCLK__HZ EQU 48000000
CYDEV_BCLK__SYSCLK__KHZ EQU 48000
CYDEV_BCLK__SYSCLK__MHZ EQU 48
CYDEV_CHIP_DIE_LEOPARD EQU 1
CYDEV_CHIP_DIE_PANTHER EQU 19
CYDEV_CHIP_DIE_PSOC4A EQU 11
CYDEV_CHIP_DIE_PSOC5LP EQU 18
CYDEV_CHIP_DIE_TMA4 EQU 2
CYDEV_CHIP_DIE_UNKNOWN EQU 0
CYDEV_CHIP_FAMILY_PSOC3 EQU 1
CYDEV_CHIP_FAMILY_PSOC4 EQU 2
CYDEV_CHIP_FAMILY_PSOC5 EQU 3
CYDEV_CHIP_FAMILY_UNKNOWN EQU 0
CYDEV_CHIP_FAMILY_USED EQU CYDEV_CHIP_FAMILY_PSOC4
CYDEV_CHIP_JTAG_ID EQU 0x112D11A1
CYDEV_CHIP_MEMBER_3A EQU 1
CYDEV_CHIP_MEMBER_4A EQU 11
CYDEV_CHIP_MEMBER_4C EQU 16
CYDEV_CHIP_MEMBER_4D EQU 7
CYDEV_CHIP_MEMBER_4E EQU 4
CYDEV_CHIP_MEMBER_4F EQU 12
CYDEV_CHIP_MEMBER_4G EQU 2
CYDEV_CHIP_MEMBER_4H EQU 10
CYDEV_CHIP_MEMBER_4I EQU 15
CYDEV_CHIP_MEMBER_4J EQU 8
CYDEV_CHIP_MEMBER_4K EQU 9
CYDEV_CHIP_MEMBER_4L EQU 14
CYDEV_CHIP_MEMBER_4M EQU 13
CYDEV_CHIP_MEMBER_4N EQU 6
CYDEV_CHIP_MEMBER_4O EQU 5
CYDEV_CHIP_MEMBER_4U EQU 3
CYDEV_CHIP_MEMBER_5A EQU 18
CYDEV_CHIP_MEMBER_5B EQU 17
CYDEV_CHIP_MEMBER_UNKNOWN EQU 0
CYDEV_CHIP_MEMBER_USED EQU CYDEV_CHIP_MEMBER_4M
CYDEV_CHIP_DIE_EXPECT EQU CYDEV_CHIP_MEMBER_USED
CYDEV_CHIP_DIE_ACTUAL EQU CYDEV_CHIP_DIE_EXPECT
CYDEV_CHIP_REV_LEOPARD_ES1 EQU 0
CYDEV_CHIP_REV_LEOPARD_ES2 EQU 1
CYDEV_CHIP_REV_LEOPARD_ES3 EQU 3
CYDEV_CHIP_REV_LEOPARD_PRODUCTION EQU 3
CYDEV_CHIP_REV_PANTHER_ES0 EQU 0
CYDEV_CHIP_REV_PANTHER_ES1 EQU 1
CYDEV_CHIP_REV_PANTHER_PRODUCTION EQU 1
CYDEV_CHIP_REV_PSOC4A_ES0 EQU 17
CYDEV_CHIP_REV_PSOC4A_PRODUCTION EQU 17
CYDEV_CHIP_REV_PSOC5LP_ES0 EQU 0
CYDEV_CHIP_REV_PSOC5LP_PRODUCTION EQU 0
CYDEV_CHIP_REV_TMA4_ES EQU 17
CYDEV_CHIP_REV_TMA4_ES2 EQU 33
CYDEV_CHIP_REV_TMA4_PRODUCTION EQU 17
CYDEV_CHIP_REVISION_3A_ES1 EQU 0
CYDEV_CHIP_REVISION_3A_ES2 EQU 1
CYDEV_CHIP_REVISION_3A_ES3 EQU 3
CYDEV_CHIP_REVISION_3A_PRODUCTION EQU 3
CYDEV_CHIP_REVISION_4A_ES0 EQU 17
CYDEV_CHIP_REVISION_4A_PRODUCTION EQU 17
CYDEV_CHIP_REVISION_4C_PRODUCTION EQU 0
CYDEV_CHIP_REVISION_4D_PRODUCTION EQU 0
CYDEV_CHIP_REVISION_4E_PRODUCTION EQU 0
CYDEV_CHIP_REVISION_4F_PRODUCTION EQU 0
CYDEV_CHIP_REVISION_4F_PRODUCTION_256DMA EQU 0
CYDEV_CHIP_REVISION_4F_PRODUCTION_256K EQU 0
CYDEV_CHIP_REVISION_4G_ES EQU 17
CYDEV_CHIP_REVISION_4G_ES2 EQU 33
CYDEV_CHIP_REVISION_4G_PRODUCTION EQU 17
CYDEV_CHIP_REVISION_4H_PRODUCTION EQU 0
CYDEV_CHIP_REVISION_4I_PRODUCTION EQU 0
CYDEV_CHIP_REVISION_4J_PRODUCTION EQU 0
CYDEV_CHIP_REVISION_4K_PRODUCTION EQU 0
CYDEV_CHIP_REVISION_4L_PRODUCTION EQU 0
CYDEV_CHIP_REVISION_4M_PRODUCTION EQU 0
CYDEV_CHIP_REVISION_4N_PRODUCTION EQU 0
CYDEV_CHIP_REVISION_4O_PRODUCTION EQU 0
CYDEV_CHIP_REVISION_4U_PRODUCTION EQU 0
CYDEV_CHIP_REVISION_5A_ES0 EQU 0
CYDEV_CHIP_REVISION_5A_ES1 EQU 1
CYDEV_CHIP_REVISION_5A_PRODUCTION EQU 1
CYDEV_CHIP_REVISION_5B_ES0 EQU 0
CYDEV_CHIP_REVISION_5B_PRODUCTION EQU 0
CYDEV_CHIP_REVISION_USED EQU CYDEV_CHIP_REVISION_4M_PRODUCTION
CYDEV_CHIP_REV_EXPECT EQU CYDEV_CHIP_REVISION_USED
CYDEV_CONFIG_READ_ACCELERATOR EQU 1
CYDEV_CONFIG_UNUSED_IO_AllowButWarn EQU 0
CYDEV_CONFIG_UNUSED_IO EQU CYDEV_CONFIG_UNUSED_IO_AllowButWarn
CYDEV_CONFIG_UNUSED_IO_AllowWithInfo EQU 1
CYDEV_CONFIG_UNUSED_IO_Disallowed EQU 2
CYDEV_CONFIGURATION_COMPRESSED EQU 1
CYDEV_CONFIGURATION_MODE_COMPRESSED EQU 0
CYDEV_CONFIGURATION_MODE EQU CYDEV_CONFIGURATION_MODE_COMPRESSED
CYDEV_CONFIGURATION_MODE_DMA EQU 2
CYDEV_CONFIGURATION_MODE_UNCOMPRESSED EQU 1
CYDEV_DEBUG_PROTECT_KILL EQU 4
CYDEV_DEBUG_PROTECT_OPEN EQU 1
CYDEV_DEBUG_PROTECT EQU CYDEV_DEBUG_PROTECT_OPEN
CYDEV_DEBUG_PROTECT_PROTECTED EQU 2
CYDEV_DEBUGGING_DPS_Disable EQU 3
CYDEV_DEBUGGING_DPS_SWD EQU 2
CYDEV_DEBUGGING_DPS EQU CYDEV_DEBUGGING_DPS_SWD
CYDEV_DEBUGGING_ENABLE EQU 1
CYDEV_DFT_SELECT_CLK0 EQU 10
CYDEV_DFT_SELECT_CLK1 EQU 11
CYDEV_DMA_CHANNELS_AVAILABLE EQU 8
CYDEV_HEAP_SIZE EQU 0x80
CYDEV_IMO_TRIMMED_BY_USB EQU 0
CYDEV_IMO_TRIMMED_BY_WCO EQU 0
CYDEV_INTR_NUMBER_DMA EQU 13
CYDEV_IS_EXPORTING_CODE EQU 0
CYDEV_IS_IMPORTING_CODE EQU 0
CYDEV_PROJ_TYPE EQU 0
CYDEV_PROJ_TYPE_BOOTLOADER EQU 1
CYDEV_PROJ_TYPE_LAUNCHER EQU 5
CYDEV_PROJ_TYPE_LOADABLE EQU 2
CYDEV_PROJ_TYPE_LOADABLEANDBOOTLOADER EQU 4
CYDEV_PROJ_TYPE_MULTIAPPBOOTLOADER EQU 3
CYDEV_PROJ_TYPE_STANDARD EQU 0
CYDEV_STACK_SIZE EQU 0x0800
CYDEV_USE_BUNDLED_CMSIS EQU 1
CYDEV_VARIABLE_VDDA EQU 1
CYDEV_VDDA_MV EQU 3300
CYDEV_VDDD_MV EQU 3300
CYDEV_VDDIO_MV EQU 3300
CYDEV_WDT_GENERATE_ISR EQU 1
CYIPBLOCK_m0s8can_VERSION EQU 1
CYIPBLOCK_m0s8cpussv2_VERSION EQU 1
CYIPBLOCK_m0s8csd_VERSION EQU 1
CYIPBLOCK_m0s8ioss_VERSION EQU 1
CYIPBLOCK_m0s8lcd_VERSION EQU 2
CYIPBLOCK_m0s8lpcomp_VERSION EQU 2
CYIPBLOCK_m0s8peri_VERSION EQU 1
CYIPBLOCK_m0s8scb_VERSION EQU 2
CYIPBLOCK_m0s8srssv2_VERSION EQU 1
CYIPBLOCK_m0s8tcpwm_VERSION EQU 2
CYIPBLOCK_m0s8udbif_VERSION EQU 1
CYIPBLOCK_m0s8wco_VERSION EQU 1
CYIPBLOCK_s8pass4al_VERSION EQU 1
DMA_CHANNELS_USED__MASK EQU 0
CYDEV_BOOTLOADER_ENABLE EQU 0
    ENDIF
    END
