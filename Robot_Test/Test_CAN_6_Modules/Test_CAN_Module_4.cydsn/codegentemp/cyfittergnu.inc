.ifndef INCLUDED_CYFITTERGNU_INC
.set INCLUDED_CYFITTERGNU_INC, 1
.include "cydevicegnu_trm.inc"

/* CAN_CanIP */
.set CAN_CanIP__BUFFER_STATUS, CYREG_CAN0_BUFFER_STATUS
.set CAN_CanIP__CAN_RX0_ACR, CYREG_CAN0_CAN_RX0_ACR
.set CAN_CanIP__CAN_RX0_ACR_DATA, CYREG_CAN0_CAN_RX0_ACR_DATA
.set CAN_CanIP__CAN_RX0_AMR, CYREG_CAN0_CAN_RX0_AMR
.set CAN_CanIP__CAN_RX0_AMR_DATA, CYREG_CAN0_CAN_RX0_AMR_DATA
.set CAN_CanIP__CAN_RX0_CONTROL, CYREG_CAN0_CAN_RX0_CONTROL
.set CAN_CanIP__CAN_RX0_DATA_HIGH, CYREG_CAN0_CAN_RX0_DATA_HIGH
.set CAN_CanIP__CAN_RX0_DATA_LOW, CYREG_CAN0_CAN_RX0_DATA_LOW
.set CAN_CanIP__CAN_RX0_ID, CYREG_CAN0_CAN_RX0_ID
.set CAN_CanIP__CAN_RX1_ACR, CYREG_CAN0_CAN_RX1_ACR
.set CAN_CanIP__CAN_RX1_ACR_DATA, CYREG_CAN0_CAN_RX1_ACR_DATA
.set CAN_CanIP__CAN_RX1_AMR, CYREG_CAN0_CAN_RX1_AMR
.set CAN_CanIP__CAN_RX1_AMR_DATA, CYREG_CAN0_CAN_RX1_AMR_DATA
.set CAN_CanIP__CAN_RX1_CONTROL, CYREG_CAN0_CAN_RX1_CONTROL
.set CAN_CanIP__CAN_RX1_DATA_HIGH, CYREG_CAN0_CAN_RX1_DATA_HIGH
.set CAN_CanIP__CAN_RX1_DATA_LOW, CYREG_CAN0_CAN_RX1_DATA_LOW
.set CAN_CanIP__CAN_RX1_ID, CYREG_CAN0_CAN_RX1_ID
.set CAN_CanIP__CAN_RX10_ACR, CYREG_CAN0_CAN_RX10_ACR
.set CAN_CanIP__CAN_RX10_ACR_DATA, CYREG_CAN0_CAN_RX10_ACR_DATA
.set CAN_CanIP__CAN_RX10_AMR, CYREG_CAN0_CAN_RX10_AMR
.set CAN_CanIP__CAN_RX10_AMR_DATA, CYREG_CAN0_CAN_RX10_AMR_DATA
.set CAN_CanIP__CAN_RX10_CONTROL, CYREG_CAN0_CAN_RX10_CONTROL
.set CAN_CanIP__CAN_RX10_DATA_HIGH, CYREG_CAN0_CAN_RX10_DATA_HIGH
.set CAN_CanIP__CAN_RX10_DATA_LOW, CYREG_CAN0_CAN_RX10_DATA_LOW
.set CAN_CanIP__CAN_RX10_ID, CYREG_CAN0_CAN_RX10_ID
.set CAN_CanIP__CAN_RX11_ACR, CYREG_CAN0_CAN_RX11_ACR
.set CAN_CanIP__CAN_RX11_ACR_DATA, CYREG_CAN0_CAN_RX11_ACR_DATA
.set CAN_CanIP__CAN_RX11_AMR, CYREG_CAN0_CAN_RX11_AMR
.set CAN_CanIP__CAN_RX11_AMR_DATA, CYREG_CAN0_CAN_RX11_AMR_DATA
.set CAN_CanIP__CAN_RX11_CONTROL, CYREG_CAN0_CAN_RX11_CONTROL
.set CAN_CanIP__CAN_RX11_DATA_HIGH, CYREG_CAN0_CAN_RX11_DATA_HIGH
.set CAN_CanIP__CAN_RX11_DATA_LOW, CYREG_CAN0_CAN_RX11_DATA_LOW
.set CAN_CanIP__CAN_RX11_ID, CYREG_CAN0_CAN_RX11_ID
.set CAN_CanIP__CAN_RX12_ACR, CYREG_CAN0_CAN_RX12_ACR
.set CAN_CanIP__CAN_RX12_ACR_DATA, CYREG_CAN0_CAN_RX12_ACR_DATA
.set CAN_CanIP__CAN_RX12_AMR, CYREG_CAN0_CAN_RX12_AMR
.set CAN_CanIP__CAN_RX12_AMR_DATA, CYREG_CAN0_CAN_RX12_AMR_DATA
.set CAN_CanIP__CAN_RX12_CONTROL, CYREG_CAN0_CAN_RX12_CONTROL
.set CAN_CanIP__CAN_RX12_DATA_HIGH, CYREG_CAN0_CAN_RX12_DATA_HIGH
.set CAN_CanIP__CAN_RX12_DATA_LOW, CYREG_CAN0_CAN_RX12_DATA_LOW
.set CAN_CanIP__CAN_RX12_ID, CYREG_CAN0_CAN_RX12_ID
.set CAN_CanIP__CAN_RX13_ACR, CYREG_CAN0_CAN_RX13_ACR
.set CAN_CanIP__CAN_RX13_ACR_DATA, CYREG_CAN0_CAN_RX13_ACR_DATA
.set CAN_CanIP__CAN_RX13_AMR, CYREG_CAN0_CAN_RX13_AMR
.set CAN_CanIP__CAN_RX13_AMR_DATA, CYREG_CAN0_CAN_RX13_AMR_DATA
.set CAN_CanIP__CAN_RX13_CONTROL, CYREG_CAN0_CAN_RX13_CONTROL
.set CAN_CanIP__CAN_RX13_DATA_HIGH, CYREG_CAN0_CAN_RX13_DATA_HIGH
.set CAN_CanIP__CAN_RX13_DATA_LOW, CYREG_CAN0_CAN_RX13_DATA_LOW
.set CAN_CanIP__CAN_RX13_ID, CYREG_CAN0_CAN_RX13_ID
.set CAN_CanIP__CAN_RX14_ACR, CYREG_CAN0_CAN_RX14_ACR
.set CAN_CanIP__CAN_RX14_ACR_DATA, CYREG_CAN0_CAN_RX14_ACR_DATA
.set CAN_CanIP__CAN_RX14_AMR, CYREG_CAN0_CAN_RX14_AMR
.set CAN_CanIP__CAN_RX14_AMR_DATA, CYREG_CAN0_CAN_RX14_AMR_DATA
.set CAN_CanIP__CAN_RX14_CONTROL, CYREG_CAN0_CAN_RX14_CONTROL
.set CAN_CanIP__CAN_RX14_DATA_HIGH, CYREG_CAN0_CAN_RX14_DATA_HIGH
.set CAN_CanIP__CAN_RX14_DATA_LOW, CYREG_CAN0_CAN_RX14_DATA_LOW
.set CAN_CanIP__CAN_RX14_ID, CYREG_CAN0_CAN_RX14_ID
.set CAN_CanIP__CAN_RX15_ACR, CYREG_CAN0_CAN_RX15_ACR
.set CAN_CanIP__CAN_RX15_ACR_DATA, CYREG_CAN0_CAN_RX15_ACR_DATA
.set CAN_CanIP__CAN_RX15_AMR, CYREG_CAN0_CAN_RX15_AMR
.set CAN_CanIP__CAN_RX15_AMR_DATA, CYREG_CAN0_CAN_RX15_AMR_DATA
.set CAN_CanIP__CAN_RX15_CONTROL, CYREG_CAN0_CAN_RX15_CONTROL
.set CAN_CanIP__CAN_RX15_DATA_HIGH, CYREG_CAN0_CAN_RX15_DATA_HIGH
.set CAN_CanIP__CAN_RX15_DATA_LOW, CYREG_CAN0_CAN_RX15_DATA_LOW
.set CAN_CanIP__CAN_RX15_ID, CYREG_CAN0_CAN_RX15_ID
.set CAN_CanIP__CAN_RX2_ACR, CYREG_CAN0_CAN_RX2_ACR
.set CAN_CanIP__CAN_RX2_ACR_DATA, CYREG_CAN0_CAN_RX2_ACR_DATA
.set CAN_CanIP__CAN_RX2_AMR, CYREG_CAN0_CAN_RX2_AMR
.set CAN_CanIP__CAN_RX2_AMR_DATA, CYREG_CAN0_CAN_RX2_AMR_DATA
.set CAN_CanIP__CAN_RX2_CONTROL, CYREG_CAN0_CAN_RX2_CONTROL
.set CAN_CanIP__CAN_RX2_DATA_HIGH, CYREG_CAN0_CAN_RX2_DATA_HIGH
.set CAN_CanIP__CAN_RX2_DATA_LOW, CYREG_CAN0_CAN_RX2_DATA_LOW
.set CAN_CanIP__CAN_RX2_ID, CYREG_CAN0_CAN_RX2_ID
.set CAN_CanIP__CAN_RX3_ACR, CYREG_CAN0_CAN_RX3_ACR
.set CAN_CanIP__CAN_RX3_ACR_DATA, CYREG_CAN0_CAN_RX3_ACR_DATA
.set CAN_CanIP__CAN_RX3_AMR, CYREG_CAN0_CAN_RX3_AMR
.set CAN_CanIP__CAN_RX3_AMR_DATA, CYREG_CAN0_CAN_RX3_AMR_DATA
.set CAN_CanIP__CAN_RX3_CONTROL, CYREG_CAN0_CAN_RX3_CONTROL
.set CAN_CanIP__CAN_RX3_DATA_HIGH, CYREG_CAN0_CAN_RX3_DATA_HIGH
.set CAN_CanIP__CAN_RX3_DATA_LOW, CYREG_CAN0_CAN_RX3_DATA_LOW
.set CAN_CanIP__CAN_RX3_ID, CYREG_CAN0_CAN_RX3_ID
.set CAN_CanIP__CAN_RX4_ACR, CYREG_CAN0_CAN_RX4_ACR
.set CAN_CanIP__CAN_RX4_ACR_DATA, CYREG_CAN0_CAN_RX4_ACR_DATA
.set CAN_CanIP__CAN_RX4_AMR, CYREG_CAN0_CAN_RX4_AMR
.set CAN_CanIP__CAN_RX4_AMR_DATA, CYREG_CAN0_CAN_RX4_AMR_DATA
.set CAN_CanIP__CAN_RX4_CONTROL, CYREG_CAN0_CAN_RX4_CONTROL
.set CAN_CanIP__CAN_RX4_DATA_HIGH, CYREG_CAN0_CAN_RX4_DATA_HIGH
.set CAN_CanIP__CAN_RX4_DATA_LOW, CYREG_CAN0_CAN_RX4_DATA_LOW
.set CAN_CanIP__CAN_RX4_ID, CYREG_CAN0_CAN_RX4_ID
.set CAN_CanIP__CAN_RX5_ACR, CYREG_CAN0_CAN_RX5_ACR
.set CAN_CanIP__CAN_RX5_ACR_DATA, CYREG_CAN0_CAN_RX5_ACR_DATA
.set CAN_CanIP__CAN_RX5_AMR, CYREG_CAN0_CAN_RX5_AMR
.set CAN_CanIP__CAN_RX5_AMR_DATA, CYREG_CAN0_CAN_RX5_AMR_DATA
.set CAN_CanIP__CAN_RX5_CONTROL, CYREG_CAN0_CAN_RX5_CONTROL
.set CAN_CanIP__CAN_RX5_DATA_HIGH, CYREG_CAN0_CAN_RX5_DATA_HIGH
.set CAN_CanIP__CAN_RX5_DATA_LOW, CYREG_CAN0_CAN_RX5_DATA_LOW
.set CAN_CanIP__CAN_RX5_ID, CYREG_CAN0_CAN_RX5_ID
.set CAN_CanIP__CAN_RX6_ACR, CYREG_CAN0_CAN_RX6_ACR
.set CAN_CanIP__CAN_RX6_ACR_DATA, CYREG_CAN0_CAN_RX6_ACR_DATA
.set CAN_CanIP__CAN_RX6_AMR, CYREG_CAN0_CAN_RX6_AMR
.set CAN_CanIP__CAN_RX6_AMR_DATA, CYREG_CAN0_CAN_RX6_AMR_DATA
.set CAN_CanIP__CAN_RX6_CONTROL, CYREG_CAN0_CAN_RX6_CONTROL
.set CAN_CanIP__CAN_RX6_DATA_HIGH, CYREG_CAN0_CAN_RX6_DATA_HIGH
.set CAN_CanIP__CAN_RX6_DATA_LOW, CYREG_CAN0_CAN_RX6_DATA_LOW
.set CAN_CanIP__CAN_RX6_ID, CYREG_CAN0_CAN_RX6_ID
.set CAN_CanIP__CAN_RX7_ACR, CYREG_CAN0_CAN_RX7_ACR
.set CAN_CanIP__CAN_RX7_ACR_DATA, CYREG_CAN0_CAN_RX7_ACR_DATA
.set CAN_CanIP__CAN_RX7_AMR, CYREG_CAN0_CAN_RX7_AMR
.set CAN_CanIP__CAN_RX7_AMR_DATA, CYREG_CAN0_CAN_RX7_AMR_DATA
.set CAN_CanIP__CAN_RX7_CONTROL, CYREG_CAN0_CAN_RX7_CONTROL
.set CAN_CanIP__CAN_RX7_DATA_HIGH, CYREG_CAN0_CAN_RX7_DATA_HIGH
.set CAN_CanIP__CAN_RX7_DATA_LOW, CYREG_CAN0_CAN_RX7_DATA_LOW
.set CAN_CanIP__CAN_RX7_ID, CYREG_CAN0_CAN_RX7_ID
.set CAN_CanIP__CAN_RX8_ACR, CYREG_CAN0_CAN_RX8_ACR
.set CAN_CanIP__CAN_RX8_ACR_DATA, CYREG_CAN0_CAN_RX8_ACR_DATA
.set CAN_CanIP__CAN_RX8_AMR, CYREG_CAN0_CAN_RX8_AMR
.set CAN_CanIP__CAN_RX8_AMR_DATA, CYREG_CAN0_CAN_RX8_AMR_DATA
.set CAN_CanIP__CAN_RX8_CONTROL, CYREG_CAN0_CAN_RX8_CONTROL
.set CAN_CanIP__CAN_RX8_DATA_HIGH, CYREG_CAN0_CAN_RX8_DATA_HIGH
.set CAN_CanIP__CAN_RX8_DATA_LOW, CYREG_CAN0_CAN_RX8_DATA_LOW
.set CAN_CanIP__CAN_RX8_ID, CYREG_CAN0_CAN_RX8_ID
.set CAN_CanIP__CAN_RX9_ACR, CYREG_CAN0_CAN_RX9_ACR
.set CAN_CanIP__CAN_RX9_ACR_DATA, CYREG_CAN0_CAN_RX9_ACR_DATA
.set CAN_CanIP__CAN_RX9_AMR, CYREG_CAN0_CAN_RX9_AMR
.set CAN_CanIP__CAN_RX9_AMR_DATA, CYREG_CAN0_CAN_RX9_AMR_DATA
.set CAN_CanIP__CAN_RX9_CONTROL, CYREG_CAN0_CAN_RX9_CONTROL
.set CAN_CanIP__CAN_RX9_DATA_HIGH, CYREG_CAN0_CAN_RX9_DATA_HIGH
.set CAN_CanIP__CAN_RX9_DATA_LOW, CYREG_CAN0_CAN_RX9_DATA_LOW
.set CAN_CanIP__CAN_RX9_ID, CYREG_CAN0_CAN_RX9_ID
.set CAN_CanIP__CAN_TX0_CONTROL, CYREG_CAN0_CAN_TX0_CONTROL
.set CAN_CanIP__CAN_TX0_DATA_HIGH, CYREG_CAN0_CAN_TX0_DATA_HIGH
.set CAN_CanIP__CAN_TX0_DATA_LOW, CYREG_CAN0_CAN_TX0_DATA_LOW
.set CAN_CanIP__CAN_TX0_ID, CYREG_CAN0_CAN_TX0_ID
.set CAN_CanIP__CAN_TX1_CONTROL, CYREG_CAN0_CAN_TX1_CONTROL
.set CAN_CanIP__CAN_TX1_DATA_HIGH, CYREG_CAN0_CAN_TX1_DATA_HIGH
.set CAN_CanIP__CAN_TX1_DATA_LOW, CYREG_CAN0_CAN_TX1_DATA_LOW
.set CAN_CanIP__CAN_TX1_ID, CYREG_CAN0_CAN_TX1_ID
.set CAN_CanIP__CAN_TX2_CONTROL, CYREG_CAN0_CAN_TX2_CONTROL
.set CAN_CanIP__CAN_TX2_DATA_HIGH, CYREG_CAN0_CAN_TX2_DATA_HIGH
.set CAN_CanIP__CAN_TX2_DATA_LOW, CYREG_CAN0_CAN_TX2_DATA_LOW
.set CAN_CanIP__CAN_TX2_ID, CYREG_CAN0_CAN_TX2_ID
.set CAN_CanIP__CAN_TX3_CONTROL, CYREG_CAN0_CAN_TX3_CONTROL
.set CAN_CanIP__CAN_TX3_DATA_HIGH, CYREG_CAN0_CAN_TX3_DATA_HIGH
.set CAN_CanIP__CAN_TX3_DATA_LOW, CYREG_CAN0_CAN_TX3_DATA_LOW
.set CAN_CanIP__CAN_TX3_ID, CYREG_CAN0_CAN_TX3_ID
.set CAN_CanIP__CAN_TX4_CONTROL, CYREG_CAN0_CAN_TX4_CONTROL
.set CAN_CanIP__CAN_TX4_DATA_HIGH, CYREG_CAN0_CAN_TX4_DATA_HIGH
.set CAN_CanIP__CAN_TX4_DATA_LOW, CYREG_CAN0_CAN_TX4_DATA_LOW
.set CAN_CanIP__CAN_TX4_ID, CYREG_CAN0_CAN_TX4_ID
.set CAN_CanIP__CAN_TX5_CONTROL, CYREG_CAN0_CAN_TX5_CONTROL
.set CAN_CanIP__CAN_TX5_DATA_HIGH, CYREG_CAN0_CAN_TX5_DATA_HIGH
.set CAN_CanIP__CAN_TX5_DATA_LOW, CYREG_CAN0_CAN_TX5_DATA_LOW
.set CAN_CanIP__CAN_TX5_ID, CYREG_CAN0_CAN_TX5_ID
.set CAN_CanIP__CAN_TX6_CONTROL, CYREG_CAN0_CAN_TX6_CONTROL
.set CAN_CanIP__CAN_TX6_DATA_HIGH, CYREG_CAN0_CAN_TX6_DATA_HIGH
.set CAN_CanIP__CAN_TX6_DATA_LOW, CYREG_CAN0_CAN_TX6_DATA_LOW
.set CAN_CanIP__CAN_TX6_ID, CYREG_CAN0_CAN_TX6_ID
.set CAN_CanIP__CAN_TX7_CONTROL, CYREG_CAN0_CAN_TX7_CONTROL
.set CAN_CanIP__CAN_TX7_DATA_HIGH, CYREG_CAN0_CAN_TX7_DATA_HIGH
.set CAN_CanIP__CAN_TX7_DATA_LOW, CYREG_CAN0_CAN_TX7_DATA_LOW
.set CAN_CanIP__CAN_TX7_ID, CYREG_CAN0_CAN_TX7_ID
.set CAN_CanIP__CNTL, CYREG_CAN0_CNTL
.set CAN_CanIP__COMMAND, CYREG_CAN0_COMMAND
.set CAN_CanIP__CONFIG, CYREG_CAN0_CONFIG
.set CAN_CanIP__ECR, CYREG_CAN0_ECR
.set CAN_CanIP__ERROR_STATUS, CYREG_CAN0_ERROR_STATUS
.set CAN_CanIP__INT_EBL, CYREG_CAN0_INT_EBL
.set CAN_CanIP__INT_STATUS, CYREG_CAN0_INT_STATUS
.set CAN_CanIP__INTR_CAN, CYREG_CAN0_INTR_CAN
.set CAN_CanIP__INTR_CAN_MASK, CYREG_CAN0_INTR_CAN_MASK
.set CAN_CanIP__INTR_CAN_MASKED, CYREG_CAN0_INTR_CAN_MASKED
.set CAN_CanIP__INTR_CAN_SET, CYREG_CAN0_INTR_CAN_SET
.set CAN_CanIP__TTCAN_CAPTURE, CYREG_CAN0_TTCAN_CAPTURE
.set CAN_CanIP__TTCAN_COMPARE, CYREG_CAN0_TTCAN_COMPARE
.set CAN_CanIP__TTCAN_COUNTER, CYREG_CAN0_TTCAN_COUNTER
.set CAN_CanIP__TTCAN_TIMING, CYREG_CAN0_TTCAN_TIMING

/* CAN_HFCLK */
.set CAN_HFCLK__DIV_ID, 0x00000040
.set CAN_HFCLK__DIV_REGISTER, CYREG_PERI_DIV_16_CTL0
.set CAN_HFCLK__PA_DIV_ID, 0x000000FF

/* CAN_isr */
.set CAN_isr__INTC_CLR_EN_REG, CYREG_CM0_ICER
.set CAN_isr__INTC_CLR_PD_REG, CYREG_CM0_ICPR
.set CAN_isr__INTC_MASK, 0x8000000
.set CAN_isr__INTC_NUMBER, 27
.set CAN_isr__INTC_PRIOR_MASK, 0xC0000000
.set CAN_isr__INTC_PRIOR_NUM, 3
.set CAN_isr__INTC_PRIOR_REG, CYREG_CM0_IPR6
.set CAN_isr__INTC_SET_EN_REG, CYREG_CM0_ISER
.set CAN_isr__INTC_SET_PD_REG, CYREG_CM0_ISPR

/* RX_1 */
.set RX_1__0__DR, CYREG_GPIO_PRT4_DR
.set RX_1__0__DR_CLR, CYREG_GPIO_PRT4_DR_CLR
.set RX_1__0__DR_INV, CYREG_GPIO_PRT4_DR_INV
.set RX_1__0__DR_SET, CYREG_GPIO_PRT4_DR_SET
.set RX_1__0__HSIOM, CYREG_HSIOM_PORT_SEL4
.set RX_1__0__HSIOM_MASK, 0x0000000F
.set RX_1__0__HSIOM_SHIFT, 0
.set RX_1__0__INTCFG, CYREG_GPIO_PRT4_INTR_CFG
.set RX_1__0__INTR, CYREG_GPIO_PRT4_INTR
.set RX_1__0__INTR_CFG, CYREG_GPIO_PRT4_INTR_CFG
.set RX_1__0__INTSTAT, CYREG_GPIO_PRT4_INTR
.set RX_1__0__MASK, 0x01
.set RX_1__0__PC, CYREG_GPIO_PRT4_PC
.set RX_1__0__PC2, CYREG_GPIO_PRT4_PC2
.set RX_1__0__PORT, 4
.set RX_1__0__PS, CYREG_GPIO_PRT4_PS
.set RX_1__0__SHIFT, 0
.set RX_1__DR, CYREG_GPIO_PRT4_DR
.set RX_1__DR_CLR, CYREG_GPIO_PRT4_DR_CLR
.set RX_1__DR_INV, CYREG_GPIO_PRT4_DR_INV
.set RX_1__DR_SET, CYREG_GPIO_PRT4_DR_SET
.set RX_1__INTCFG, CYREG_GPIO_PRT4_INTR_CFG
.set RX_1__INTR, CYREG_GPIO_PRT4_INTR
.set RX_1__INTR_CFG, CYREG_GPIO_PRT4_INTR_CFG
.set RX_1__INTSTAT, CYREG_GPIO_PRT4_INTR
.set RX_1__MASK, 0x01
.set RX_1__PC, CYREG_GPIO_PRT4_PC
.set RX_1__PC2, CYREG_GPIO_PRT4_PC2
.set RX_1__PORT, 4
.set RX_1__PS, CYREG_GPIO_PRT4_PS
.set RX_1__SHIFT, 0

/* TX_1 */
.set TX_1__0__DR, CYREG_GPIO_PRT4_DR
.set TX_1__0__DR_CLR, CYREG_GPIO_PRT4_DR_CLR
.set TX_1__0__DR_INV, CYREG_GPIO_PRT4_DR_INV
.set TX_1__0__DR_SET, CYREG_GPIO_PRT4_DR_SET
.set TX_1__0__HSIOM, CYREG_HSIOM_PORT_SEL4
.set TX_1__0__HSIOM_MASK, 0x000000F0
.set TX_1__0__HSIOM_SHIFT, 4
.set TX_1__0__INTCFG, CYREG_GPIO_PRT4_INTR_CFG
.set TX_1__0__INTR, CYREG_GPIO_PRT4_INTR
.set TX_1__0__INTR_CFG, CYREG_GPIO_PRT4_INTR_CFG
.set TX_1__0__INTSTAT, CYREG_GPIO_PRT4_INTR
.set TX_1__0__MASK, 0x02
.set TX_1__0__PC, CYREG_GPIO_PRT4_PC
.set TX_1__0__PC2, CYREG_GPIO_PRT4_PC2
.set TX_1__0__PORT, 4
.set TX_1__0__PS, CYREG_GPIO_PRT4_PS
.set TX_1__0__SHIFT, 1
.set TX_1__DR, CYREG_GPIO_PRT4_DR
.set TX_1__DR_CLR, CYREG_GPIO_PRT4_DR_CLR
.set TX_1__DR_INV, CYREG_GPIO_PRT4_DR_INV
.set TX_1__DR_SET, CYREG_GPIO_PRT4_DR_SET
.set TX_1__INTCFG, CYREG_GPIO_PRT4_INTR_CFG
.set TX_1__INTR, CYREG_GPIO_PRT4_INTR
.set TX_1__INTR_CFG, CYREG_GPIO_PRT4_INTR_CFG
.set TX_1__INTSTAT, CYREG_GPIO_PRT4_INTR
.set TX_1__MASK, 0x02
.set TX_1__PC, CYREG_GPIO_PRT4_PC
.set TX_1__PC2, CYREG_GPIO_PRT4_PC2
.set TX_1__PORT, 4
.set TX_1__PS, CYREG_GPIO_PRT4_PS
.set TX_1__SHIFT, 1

/* LED_1 */
.set LED_1__0__DR, CYREG_GPIO_PRT2_DR
.set LED_1__0__DR_CLR, CYREG_GPIO_PRT2_DR_CLR
.set LED_1__0__DR_INV, CYREG_GPIO_PRT2_DR_INV
.set LED_1__0__DR_SET, CYREG_GPIO_PRT2_DR_SET
.set LED_1__0__HSIOM, CYREG_HSIOM_PORT_SEL2
.set LED_1__0__HSIOM_MASK, 0x00000F00
.set LED_1__0__HSIOM_SHIFT, 8
.set LED_1__0__INTCFG, CYREG_GPIO_PRT2_INTR_CFG
.set LED_1__0__INTR, CYREG_GPIO_PRT2_INTR
.set LED_1__0__INTR_CFG, CYREG_GPIO_PRT2_INTR_CFG
.set LED_1__0__INTSTAT, CYREG_GPIO_PRT2_INTR
.set LED_1__0__MASK, 0x04
.set LED_1__0__PA__CFG0, CYREG_UDB_PA2_CFG0
.set LED_1__0__PA__CFG1, CYREG_UDB_PA2_CFG1
.set LED_1__0__PA__CFG10, CYREG_UDB_PA2_CFG10
.set LED_1__0__PA__CFG11, CYREG_UDB_PA2_CFG11
.set LED_1__0__PA__CFG12, CYREG_UDB_PA2_CFG12
.set LED_1__0__PA__CFG13, CYREG_UDB_PA2_CFG13
.set LED_1__0__PA__CFG14, CYREG_UDB_PA2_CFG14
.set LED_1__0__PA__CFG2, CYREG_UDB_PA2_CFG2
.set LED_1__0__PA__CFG3, CYREG_UDB_PA2_CFG3
.set LED_1__0__PA__CFG4, CYREG_UDB_PA2_CFG4
.set LED_1__0__PA__CFG5, CYREG_UDB_PA2_CFG5
.set LED_1__0__PA__CFG6, CYREG_UDB_PA2_CFG6
.set LED_1__0__PA__CFG7, CYREG_UDB_PA2_CFG7
.set LED_1__0__PA__CFG8, CYREG_UDB_PA2_CFG8
.set LED_1__0__PA__CFG9, CYREG_UDB_PA2_CFG9
.set LED_1__0__PC, CYREG_GPIO_PRT2_PC
.set LED_1__0__PC2, CYREG_GPIO_PRT2_PC2
.set LED_1__0__PORT, 2
.set LED_1__0__PS, CYREG_GPIO_PRT2_PS
.set LED_1__0__SHIFT, 2
.set LED_1__DR, CYREG_GPIO_PRT2_DR
.set LED_1__DR_CLR, CYREG_GPIO_PRT2_DR_CLR
.set LED_1__DR_INV, CYREG_GPIO_PRT2_DR_INV
.set LED_1__DR_SET, CYREG_GPIO_PRT2_DR_SET
.set LED_1__INTCFG, CYREG_GPIO_PRT2_INTR_CFG
.set LED_1__INTR, CYREG_GPIO_PRT2_INTR
.set LED_1__INTR_CFG, CYREG_GPIO_PRT2_INTR_CFG
.set LED_1__INTSTAT, CYREG_GPIO_PRT2_INTR
.set LED_1__MASK, 0x04
.set LED_1__PA__CFG0, CYREG_UDB_PA2_CFG0
.set LED_1__PA__CFG1, CYREG_UDB_PA2_CFG1
.set LED_1__PA__CFG10, CYREG_UDB_PA2_CFG10
.set LED_1__PA__CFG11, CYREG_UDB_PA2_CFG11
.set LED_1__PA__CFG12, CYREG_UDB_PA2_CFG12
.set LED_1__PA__CFG13, CYREG_UDB_PA2_CFG13
.set LED_1__PA__CFG14, CYREG_UDB_PA2_CFG14
.set LED_1__PA__CFG2, CYREG_UDB_PA2_CFG2
.set LED_1__PA__CFG3, CYREG_UDB_PA2_CFG3
.set LED_1__PA__CFG4, CYREG_UDB_PA2_CFG4
.set LED_1__PA__CFG5, CYREG_UDB_PA2_CFG5
.set LED_1__PA__CFG6, CYREG_UDB_PA2_CFG6
.set LED_1__PA__CFG7, CYREG_UDB_PA2_CFG7
.set LED_1__PA__CFG8, CYREG_UDB_PA2_CFG8
.set LED_1__PA__CFG9, CYREG_UDB_PA2_CFG9
.set LED_1__PC, CYREG_GPIO_PRT2_PC
.set LED_1__PC2, CYREG_GPIO_PRT2_PC2
.set LED_1__PORT, 2
.set LED_1__PS, CYREG_GPIO_PRT2_PS
.set LED_1__SHIFT, 2

/* LED_2 */
.set LED_2__0__DR, CYREG_GPIO_PRT2_DR
.set LED_2__0__DR_CLR, CYREG_GPIO_PRT2_DR_CLR
.set LED_2__0__DR_INV, CYREG_GPIO_PRT2_DR_INV
.set LED_2__0__DR_SET, CYREG_GPIO_PRT2_DR_SET
.set LED_2__0__HSIOM, CYREG_HSIOM_PORT_SEL2
.set LED_2__0__HSIOM_MASK, 0x0000F000
.set LED_2__0__HSIOM_SHIFT, 12
.set LED_2__0__INTCFG, CYREG_GPIO_PRT2_INTR_CFG
.set LED_2__0__INTR, CYREG_GPIO_PRT2_INTR
.set LED_2__0__INTR_CFG, CYREG_GPIO_PRT2_INTR_CFG
.set LED_2__0__INTSTAT, CYREG_GPIO_PRT2_INTR
.set LED_2__0__MASK, 0x08
.set LED_2__0__PA__CFG0, CYREG_UDB_PA2_CFG0
.set LED_2__0__PA__CFG1, CYREG_UDB_PA2_CFG1
.set LED_2__0__PA__CFG10, CYREG_UDB_PA2_CFG10
.set LED_2__0__PA__CFG11, CYREG_UDB_PA2_CFG11
.set LED_2__0__PA__CFG12, CYREG_UDB_PA2_CFG12
.set LED_2__0__PA__CFG13, CYREG_UDB_PA2_CFG13
.set LED_2__0__PA__CFG14, CYREG_UDB_PA2_CFG14
.set LED_2__0__PA__CFG2, CYREG_UDB_PA2_CFG2
.set LED_2__0__PA__CFG3, CYREG_UDB_PA2_CFG3
.set LED_2__0__PA__CFG4, CYREG_UDB_PA2_CFG4
.set LED_2__0__PA__CFG5, CYREG_UDB_PA2_CFG5
.set LED_2__0__PA__CFG6, CYREG_UDB_PA2_CFG6
.set LED_2__0__PA__CFG7, CYREG_UDB_PA2_CFG7
.set LED_2__0__PA__CFG8, CYREG_UDB_PA2_CFG8
.set LED_2__0__PA__CFG9, CYREG_UDB_PA2_CFG9
.set LED_2__0__PC, CYREG_GPIO_PRT2_PC
.set LED_2__0__PC2, CYREG_GPIO_PRT2_PC2
.set LED_2__0__PORT, 2
.set LED_2__0__PS, CYREG_GPIO_PRT2_PS
.set LED_2__0__SHIFT, 3
.set LED_2__DR, CYREG_GPIO_PRT2_DR
.set LED_2__DR_CLR, CYREG_GPIO_PRT2_DR_CLR
.set LED_2__DR_INV, CYREG_GPIO_PRT2_DR_INV
.set LED_2__DR_SET, CYREG_GPIO_PRT2_DR_SET
.set LED_2__INTCFG, CYREG_GPIO_PRT2_INTR_CFG
.set LED_2__INTR, CYREG_GPIO_PRT2_INTR
.set LED_2__INTR_CFG, CYREG_GPIO_PRT2_INTR_CFG
.set LED_2__INTSTAT, CYREG_GPIO_PRT2_INTR
.set LED_2__MASK, 0x08
.set LED_2__PA__CFG0, CYREG_UDB_PA2_CFG0
.set LED_2__PA__CFG1, CYREG_UDB_PA2_CFG1
.set LED_2__PA__CFG10, CYREG_UDB_PA2_CFG10
.set LED_2__PA__CFG11, CYREG_UDB_PA2_CFG11
.set LED_2__PA__CFG12, CYREG_UDB_PA2_CFG12
.set LED_2__PA__CFG13, CYREG_UDB_PA2_CFG13
.set LED_2__PA__CFG14, CYREG_UDB_PA2_CFG14
.set LED_2__PA__CFG2, CYREG_UDB_PA2_CFG2
.set LED_2__PA__CFG3, CYREG_UDB_PA2_CFG3
.set LED_2__PA__CFG4, CYREG_UDB_PA2_CFG4
.set LED_2__PA__CFG5, CYREG_UDB_PA2_CFG5
.set LED_2__PA__CFG6, CYREG_UDB_PA2_CFG6
.set LED_2__PA__CFG7, CYREG_UDB_PA2_CFG7
.set LED_2__PA__CFG8, CYREG_UDB_PA2_CFG8
.set LED_2__PA__CFG9, CYREG_UDB_PA2_CFG9
.set LED_2__PC, CYREG_GPIO_PRT2_PC
.set LED_2__PC2, CYREG_GPIO_PRT2_PC2
.set LED_2__PORT, 2
.set LED_2__PS, CYREG_GPIO_PRT2_PS
.set LED_2__SHIFT, 3

/* LED_3 */
.set LED_3__0__DR, CYREG_GPIO_PRT2_DR
.set LED_3__0__DR_CLR, CYREG_GPIO_PRT2_DR_CLR
.set LED_3__0__DR_INV, CYREG_GPIO_PRT2_DR_INV
.set LED_3__0__DR_SET, CYREG_GPIO_PRT2_DR_SET
.set LED_3__0__HSIOM, CYREG_HSIOM_PORT_SEL2
.set LED_3__0__HSIOM_MASK, 0x000F0000
.set LED_3__0__HSIOM_SHIFT, 16
.set LED_3__0__INTCFG, CYREG_GPIO_PRT2_INTR_CFG
.set LED_3__0__INTR, CYREG_GPIO_PRT2_INTR
.set LED_3__0__INTR_CFG, CYREG_GPIO_PRT2_INTR_CFG
.set LED_3__0__INTSTAT, CYREG_GPIO_PRT2_INTR
.set LED_3__0__MASK, 0x10
.set LED_3__0__PA__CFG0, CYREG_UDB_PA2_CFG0
.set LED_3__0__PA__CFG1, CYREG_UDB_PA2_CFG1
.set LED_3__0__PA__CFG10, CYREG_UDB_PA2_CFG10
.set LED_3__0__PA__CFG11, CYREG_UDB_PA2_CFG11
.set LED_3__0__PA__CFG12, CYREG_UDB_PA2_CFG12
.set LED_3__0__PA__CFG13, CYREG_UDB_PA2_CFG13
.set LED_3__0__PA__CFG14, CYREG_UDB_PA2_CFG14
.set LED_3__0__PA__CFG2, CYREG_UDB_PA2_CFG2
.set LED_3__0__PA__CFG3, CYREG_UDB_PA2_CFG3
.set LED_3__0__PA__CFG4, CYREG_UDB_PA2_CFG4
.set LED_3__0__PA__CFG5, CYREG_UDB_PA2_CFG5
.set LED_3__0__PA__CFG6, CYREG_UDB_PA2_CFG6
.set LED_3__0__PA__CFG7, CYREG_UDB_PA2_CFG7
.set LED_3__0__PA__CFG8, CYREG_UDB_PA2_CFG8
.set LED_3__0__PA__CFG9, CYREG_UDB_PA2_CFG9
.set LED_3__0__PC, CYREG_GPIO_PRT2_PC
.set LED_3__0__PC2, CYREG_GPIO_PRT2_PC2
.set LED_3__0__PORT, 2
.set LED_3__0__PS, CYREG_GPIO_PRT2_PS
.set LED_3__0__SHIFT, 4
.set LED_3__DR, CYREG_GPIO_PRT2_DR
.set LED_3__DR_CLR, CYREG_GPIO_PRT2_DR_CLR
.set LED_3__DR_INV, CYREG_GPIO_PRT2_DR_INV
.set LED_3__DR_SET, CYREG_GPIO_PRT2_DR_SET
.set LED_3__INTCFG, CYREG_GPIO_PRT2_INTR_CFG
.set LED_3__INTR, CYREG_GPIO_PRT2_INTR
.set LED_3__INTR_CFG, CYREG_GPIO_PRT2_INTR_CFG
.set LED_3__INTSTAT, CYREG_GPIO_PRT2_INTR
.set LED_3__MASK, 0x10
.set LED_3__PA__CFG0, CYREG_UDB_PA2_CFG0
.set LED_3__PA__CFG1, CYREG_UDB_PA2_CFG1
.set LED_3__PA__CFG10, CYREG_UDB_PA2_CFG10
.set LED_3__PA__CFG11, CYREG_UDB_PA2_CFG11
.set LED_3__PA__CFG12, CYREG_UDB_PA2_CFG12
.set LED_3__PA__CFG13, CYREG_UDB_PA2_CFG13
.set LED_3__PA__CFG14, CYREG_UDB_PA2_CFG14
.set LED_3__PA__CFG2, CYREG_UDB_PA2_CFG2
.set LED_3__PA__CFG3, CYREG_UDB_PA2_CFG3
.set LED_3__PA__CFG4, CYREG_UDB_PA2_CFG4
.set LED_3__PA__CFG5, CYREG_UDB_PA2_CFG5
.set LED_3__PA__CFG6, CYREG_UDB_PA2_CFG6
.set LED_3__PA__CFG7, CYREG_UDB_PA2_CFG7
.set LED_3__PA__CFG8, CYREG_UDB_PA2_CFG8
.set LED_3__PA__CFG9, CYREG_UDB_PA2_CFG9
.set LED_3__PC, CYREG_GPIO_PRT2_PC
.set LED_3__PC2, CYREG_GPIO_PRT2_PC2
.set LED_3__PORT, 2
.set LED_3__PS, CYREG_GPIO_PRT2_PS
.set LED_3__SHIFT, 4

/* LED_4 */
.set LED_4__0__DR, CYREG_GPIO_PRT2_DR
.set LED_4__0__DR_CLR, CYREG_GPIO_PRT2_DR_CLR
.set LED_4__0__DR_INV, CYREG_GPIO_PRT2_DR_INV
.set LED_4__0__DR_SET, CYREG_GPIO_PRT2_DR_SET
.set LED_4__0__HSIOM, CYREG_HSIOM_PORT_SEL2
.set LED_4__0__HSIOM_MASK, 0x00F00000
.set LED_4__0__HSIOM_SHIFT, 20
.set LED_4__0__INTCFG, CYREG_GPIO_PRT2_INTR_CFG
.set LED_4__0__INTR, CYREG_GPIO_PRT2_INTR
.set LED_4__0__INTR_CFG, CYREG_GPIO_PRT2_INTR_CFG
.set LED_4__0__INTSTAT, CYREG_GPIO_PRT2_INTR
.set LED_4__0__MASK, 0x20
.set LED_4__0__PA__CFG0, CYREG_UDB_PA2_CFG0
.set LED_4__0__PA__CFG1, CYREG_UDB_PA2_CFG1
.set LED_4__0__PA__CFG10, CYREG_UDB_PA2_CFG10
.set LED_4__0__PA__CFG11, CYREG_UDB_PA2_CFG11
.set LED_4__0__PA__CFG12, CYREG_UDB_PA2_CFG12
.set LED_4__0__PA__CFG13, CYREG_UDB_PA2_CFG13
.set LED_4__0__PA__CFG14, CYREG_UDB_PA2_CFG14
.set LED_4__0__PA__CFG2, CYREG_UDB_PA2_CFG2
.set LED_4__0__PA__CFG3, CYREG_UDB_PA2_CFG3
.set LED_4__0__PA__CFG4, CYREG_UDB_PA2_CFG4
.set LED_4__0__PA__CFG5, CYREG_UDB_PA2_CFG5
.set LED_4__0__PA__CFG6, CYREG_UDB_PA2_CFG6
.set LED_4__0__PA__CFG7, CYREG_UDB_PA2_CFG7
.set LED_4__0__PA__CFG8, CYREG_UDB_PA2_CFG8
.set LED_4__0__PA__CFG9, CYREG_UDB_PA2_CFG9
.set LED_4__0__PC, CYREG_GPIO_PRT2_PC
.set LED_4__0__PC2, CYREG_GPIO_PRT2_PC2
.set LED_4__0__PORT, 2
.set LED_4__0__PS, CYREG_GPIO_PRT2_PS
.set LED_4__0__SHIFT, 5
.set LED_4__DR, CYREG_GPIO_PRT2_DR
.set LED_4__DR_CLR, CYREG_GPIO_PRT2_DR_CLR
.set LED_4__DR_INV, CYREG_GPIO_PRT2_DR_INV
.set LED_4__DR_SET, CYREG_GPIO_PRT2_DR_SET
.set LED_4__INTCFG, CYREG_GPIO_PRT2_INTR_CFG
.set LED_4__INTR, CYREG_GPIO_PRT2_INTR
.set LED_4__INTR_CFG, CYREG_GPIO_PRT2_INTR_CFG
.set LED_4__INTSTAT, CYREG_GPIO_PRT2_INTR
.set LED_4__MASK, 0x20
.set LED_4__PA__CFG0, CYREG_UDB_PA2_CFG0
.set LED_4__PA__CFG1, CYREG_UDB_PA2_CFG1
.set LED_4__PA__CFG10, CYREG_UDB_PA2_CFG10
.set LED_4__PA__CFG11, CYREG_UDB_PA2_CFG11
.set LED_4__PA__CFG12, CYREG_UDB_PA2_CFG12
.set LED_4__PA__CFG13, CYREG_UDB_PA2_CFG13
.set LED_4__PA__CFG14, CYREG_UDB_PA2_CFG14
.set LED_4__PA__CFG2, CYREG_UDB_PA2_CFG2
.set LED_4__PA__CFG3, CYREG_UDB_PA2_CFG3
.set LED_4__PA__CFG4, CYREG_UDB_PA2_CFG4
.set LED_4__PA__CFG5, CYREG_UDB_PA2_CFG5
.set LED_4__PA__CFG6, CYREG_UDB_PA2_CFG6
.set LED_4__PA__CFG7, CYREG_UDB_PA2_CFG7
.set LED_4__PA__CFG8, CYREG_UDB_PA2_CFG8
.set LED_4__PA__CFG9, CYREG_UDB_PA2_CFG9
.set LED_4__PC, CYREG_GPIO_PRT2_PC
.set LED_4__PC2, CYREG_GPIO_PRT2_PC2
.set LED_4__PORT, 2
.set LED_4__PS, CYREG_GPIO_PRT2_PS
.set LED_4__SHIFT, 5

/* Miscellaneous */
.set CYDEV_BCLK__HFCLK__HZ, 24000000
.set CYDEV_BCLK__HFCLK__KHZ, 24000
.set CYDEV_BCLK__HFCLK__MHZ, 24
.set CYDEV_BCLK__SYSCLK__HZ, 24000000
.set CYDEV_BCLK__SYSCLK__KHZ, 24000
.set CYDEV_BCLK__SYSCLK__MHZ, 24
.set CYDEV_CHIP_DIE_LEOPARD, 1
.set CYDEV_CHIP_DIE_PANTHER, 19
.set CYDEV_CHIP_DIE_PSOC4A, 11
.set CYDEV_CHIP_DIE_PSOC5LP, 18
.set CYDEV_CHIP_DIE_TMA4, 2
.set CYDEV_CHIP_DIE_UNKNOWN, 0
.set CYDEV_CHIP_FAMILY_PSOC3, 1
.set CYDEV_CHIP_FAMILY_PSOC4, 2
.set CYDEV_CHIP_FAMILY_PSOC5, 3
.set CYDEV_CHIP_FAMILY_UNKNOWN, 0
.set CYDEV_CHIP_FAMILY_USED, CYDEV_CHIP_FAMILY_PSOC4
.set CYDEV_CHIP_JTAG_ID, 0x112D11A1
.set CYDEV_CHIP_MEMBER_3A, 1
.set CYDEV_CHIP_MEMBER_4A, 11
.set CYDEV_CHIP_MEMBER_4C, 16
.set CYDEV_CHIP_MEMBER_4D, 7
.set CYDEV_CHIP_MEMBER_4E, 4
.set CYDEV_CHIP_MEMBER_4F, 12
.set CYDEV_CHIP_MEMBER_4G, 2
.set CYDEV_CHIP_MEMBER_4H, 10
.set CYDEV_CHIP_MEMBER_4I, 15
.set CYDEV_CHIP_MEMBER_4J, 8
.set CYDEV_CHIP_MEMBER_4K, 9
.set CYDEV_CHIP_MEMBER_4L, 14
.set CYDEV_CHIP_MEMBER_4M, 13
.set CYDEV_CHIP_MEMBER_4N, 6
.set CYDEV_CHIP_MEMBER_4O, 5
.set CYDEV_CHIP_MEMBER_4U, 3
.set CYDEV_CHIP_MEMBER_5A, 18
.set CYDEV_CHIP_MEMBER_5B, 17
.set CYDEV_CHIP_MEMBER_UNKNOWN, 0
.set CYDEV_CHIP_MEMBER_USED, CYDEV_CHIP_MEMBER_4M
.set CYDEV_CHIP_DIE_EXPECT, CYDEV_CHIP_MEMBER_USED
.set CYDEV_CHIP_DIE_ACTUAL, CYDEV_CHIP_DIE_EXPECT
.set CYDEV_CHIP_REV_LEOPARD_ES1, 0
.set CYDEV_CHIP_REV_LEOPARD_ES2, 1
.set CYDEV_CHIP_REV_LEOPARD_ES3, 3
.set CYDEV_CHIP_REV_LEOPARD_PRODUCTION, 3
.set CYDEV_CHIP_REV_PANTHER_ES0, 0
.set CYDEV_CHIP_REV_PANTHER_ES1, 1
.set CYDEV_CHIP_REV_PANTHER_PRODUCTION, 1
.set CYDEV_CHIP_REV_PSOC4A_ES0, 17
.set CYDEV_CHIP_REV_PSOC4A_PRODUCTION, 17
.set CYDEV_CHIP_REV_PSOC5LP_ES0, 0
.set CYDEV_CHIP_REV_PSOC5LP_PRODUCTION, 0
.set CYDEV_CHIP_REV_TMA4_ES, 17
.set CYDEV_CHIP_REV_TMA4_ES2, 33
.set CYDEV_CHIP_REV_TMA4_PRODUCTION, 17
.set CYDEV_CHIP_REVISION_3A_ES1, 0
.set CYDEV_CHIP_REVISION_3A_ES2, 1
.set CYDEV_CHIP_REVISION_3A_ES3, 3
.set CYDEV_CHIP_REVISION_3A_PRODUCTION, 3
.set CYDEV_CHIP_REVISION_4A_ES0, 17
.set CYDEV_CHIP_REVISION_4A_PRODUCTION, 17
.set CYDEV_CHIP_REVISION_4C_PRODUCTION, 0
.set CYDEV_CHIP_REVISION_4D_PRODUCTION, 0
.set CYDEV_CHIP_REVISION_4E_PRODUCTION, 0
.set CYDEV_CHIP_REVISION_4F_PRODUCTION, 0
.set CYDEV_CHIP_REVISION_4F_PRODUCTION_256DMA, 0
.set CYDEV_CHIP_REVISION_4F_PRODUCTION_256K, 0
.set CYDEV_CHIP_REVISION_4G_ES, 17
.set CYDEV_CHIP_REVISION_4G_ES2, 33
.set CYDEV_CHIP_REVISION_4G_PRODUCTION, 17
.set CYDEV_CHIP_REVISION_4H_PRODUCTION, 0
.set CYDEV_CHIP_REVISION_4I_PRODUCTION, 0
.set CYDEV_CHIP_REVISION_4J_PRODUCTION, 0
.set CYDEV_CHIP_REVISION_4K_PRODUCTION, 0
.set CYDEV_CHIP_REVISION_4L_PRODUCTION, 0
.set CYDEV_CHIP_REVISION_4M_PRODUCTION, 0
.set CYDEV_CHIP_REVISION_4N_PRODUCTION, 0
.set CYDEV_CHIP_REVISION_4O_PRODUCTION, 0
.set CYDEV_CHIP_REVISION_4U_PRODUCTION, 0
.set CYDEV_CHIP_REVISION_5A_ES0, 0
.set CYDEV_CHIP_REVISION_5A_ES1, 1
.set CYDEV_CHIP_REVISION_5A_PRODUCTION, 1
.set CYDEV_CHIP_REVISION_5B_ES0, 0
.set CYDEV_CHIP_REVISION_5B_PRODUCTION, 0
.set CYDEV_CHIP_REVISION_USED, CYDEV_CHIP_REVISION_4M_PRODUCTION
.set CYDEV_CHIP_REV_EXPECT, CYDEV_CHIP_REVISION_USED
.set CYDEV_CONFIG_READ_ACCELERATOR, 1
.set CYDEV_CONFIG_UNUSED_IO_AllowButWarn, 0
.set CYDEV_CONFIG_UNUSED_IO, CYDEV_CONFIG_UNUSED_IO_AllowButWarn
.set CYDEV_CONFIG_UNUSED_IO_AllowWithInfo, 1
.set CYDEV_CONFIG_UNUSED_IO_Disallowed, 2
.set CYDEV_CONFIGURATION_COMPRESSED, 1
.set CYDEV_CONFIGURATION_MODE_COMPRESSED, 0
.set CYDEV_CONFIGURATION_MODE, CYDEV_CONFIGURATION_MODE_COMPRESSED
.set CYDEV_CONFIGURATION_MODE_DMA, 2
.set CYDEV_CONFIGURATION_MODE_UNCOMPRESSED, 1
.set CYDEV_DEBUG_PROTECT_KILL, 4
.set CYDEV_DEBUG_PROTECT_OPEN, 1
.set CYDEV_DEBUG_PROTECT, CYDEV_DEBUG_PROTECT_OPEN
.set CYDEV_DEBUG_PROTECT_PROTECTED, 2
.set CYDEV_DEBUGGING_DPS_Disable, 3
.set CYDEV_DEBUGGING_DPS_SWD, 2
.set CYDEV_DEBUGGING_DPS, CYDEV_DEBUGGING_DPS_SWD
.set CYDEV_DEBUGGING_ENABLE, 1
.set CYDEV_DFT_SELECT_CLK0, 10
.set CYDEV_DFT_SELECT_CLK1, 11
.set CYDEV_DMA_CHANNELS_AVAILABLE, 8
.set CYDEV_HEAP_SIZE, 0x80
.set CYDEV_IMO_TRIMMED_BY_USB, 0
.set CYDEV_IMO_TRIMMED_BY_WCO, 1
.set CYDEV_INTR_NUMBER_DMA, 13
.set CYDEV_IS_EXPORTING_CODE, 0
.set CYDEV_IS_IMPORTING_CODE, 0
.set CYDEV_PROJ_TYPE, 0
.set CYDEV_PROJ_TYPE_BOOTLOADER, 1
.set CYDEV_PROJ_TYPE_LAUNCHER, 5
.set CYDEV_PROJ_TYPE_LOADABLE, 2
.set CYDEV_PROJ_TYPE_LOADABLEANDBOOTLOADER, 4
.set CYDEV_PROJ_TYPE_MULTIAPPBOOTLOADER, 3
.set CYDEV_PROJ_TYPE_STANDARD, 0
.set CYDEV_STACK_SIZE, 0x0800
.set CYDEV_USE_BUNDLED_CMSIS, 1
.set CYDEV_VARIABLE_VDDA, 1
.set CYDEV_VDDA_MV, 3300
.set CYDEV_VDDD_MV, 3300
.set CYDEV_VDDIO_MV, 3300
.set CYDEV_WDT_GENERATE_ISR, 1
.set CYIPBLOCK_m0s8can_VERSION, 1
.set CYIPBLOCK_m0s8cpussv2_VERSION, 1
.set CYIPBLOCK_m0s8csd_VERSION, 1
.set CYIPBLOCK_m0s8ioss_VERSION, 1
.set CYIPBLOCK_m0s8lcd_VERSION, 2
.set CYIPBLOCK_m0s8lpcomp_VERSION, 2
.set CYIPBLOCK_m0s8peri_VERSION, 1
.set CYIPBLOCK_m0s8scb_VERSION, 2
.set CYIPBLOCK_m0s8srssv2_VERSION, 1
.set CYIPBLOCK_m0s8tcpwm_VERSION, 2
.set CYIPBLOCK_m0s8udbif_VERSION, 1
.set CYIPBLOCK_m0s8wco_VERSION, 1
.set CYIPBLOCK_s8pass4al_VERSION, 1
.set DMA_CHANNELS_USED__MASK, 0
.set CYDEV_BOOTLOADER_ENABLE, 0
.endif
